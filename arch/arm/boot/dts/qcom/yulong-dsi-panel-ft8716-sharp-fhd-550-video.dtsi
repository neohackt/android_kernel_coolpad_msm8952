/* Copyright (c) 2014, The Linux Foundation. All rights reserved.
 *
 * This program is free software; you can redistribute it and/or modify
 * it under the terms of the GNU General Public License version 2 and
 * only version 2 as published by the Free Software Foundation.
 *
 * This program is distributed in the hope that it will be useful,
 * but WITHOUT ANY WARRANTY; without even the implied warranty of
 * MERCHANTABILITY or FITNESS FOR A PARTICULAR PURPOSE.  See the
 * GNU General Public License for more details.
 */

/*---------------------------------------------------------------------------
 * This file is autogenerated file using gcdb parser. Please do not edit it.
 * Update input XML file to add a new entry or update variable in this file
 * VERSION = "1.0"
 *---------------------------------------------------------------------------*/

&mdss_mdp {
    dsi_ft8716_sharp_fhd_vid: qcom,mdss_dsi_ft8716_sharp_fhd_video {
    qcom,cont-splash-enabled;
    qcom,mdss-dsi-panel-name = "LCD_TYPE_FT8716_SHARP_FHD";
    qcom,mdss-dsi-panel-type = "dsi_video_mode";
    qcom,mdss-dsi-panel-framerate = <60>;
    qcom,mdss-dsi-virtual-channel-id = <0>;
    qcom,mdss-dsi-stream = <0>;
    qcom,mdss-dsi-panel-width = <1080>;
    qcom,mdss-dsi-panel-height = <1920>;
    qcom,mdss-dsi-h-front-porch = <80>;
    qcom,mdss-dsi-h-back-porch = <80>;
    qcom,mdss-dsi-h-pulse-width = <20>;
    qcom,mdss-dsi-h-sync-skew = <0>;
    qcom,mdss-dsi-v-front-porch = <16>;
    qcom,mdss-dsi-v-back-porch = <16>;
    qcom,mdss-dsi-v-pulse-width = <2>;
    qcom,mdss-dsi-h-left-border = <0>;
    qcom,mdss-dsi-h-right-border = <0>;
    qcom,mdss-dsi-v-top-border = <0>;
    qcom,mdss-dsi-v-bottom-border = <0>;
    qcom,mdss-dsi-bpp = <24>;
    qcom,mdss-dsi-underflow-color = <0xff>;
    qcom,mdss-dsi-border-color = <0>;
    qcom,mdss-dsi-pixel-packing = <0>;
    qcom,mdss-dsi-on-command = [
	05 01 00 00 78 00 02 11 00
	39 01 00 00 00 00 03 51 00 00
	39 01 00 00 00 00 02 53 24
	05 01 00 00 14 00 02 29 00
	];
    qcom,mdss-dsi-off-command = [
	05 01 00 00 14 00 02 28 00
	05 01 00 00 78 00 02 10 00
	];
    qcom,panel-backlight-response-curve = [
	00 01 01 01 02 02 02 02
	03 03 03 03 04 04 05 05
	06 06 07 07 08 08 09 0A
	0A 0B 0B 0C 0C 0D 0D 0E
	0E 0F 10 10 11 11 12 12
	13 13 14 14 15 16 16 17
	17 18 18 19 19 1A 1A 1B
	1C 1C 1D 1D 1E 1E 1F 1F
	20 20 21 21 22 23 23 24
	24 25 25 26 26 27 27 28
	29 29 2A 2A 2B 2B 2C 2C
	2D 2D 2E 2F 2F 30 30 31
	31 32 32 33 33 34 35 36
	37 38 3A 3B 3C 3D 3F 40
	41 43 44 45 46 48 49 4A
	4C 4D 4E 4F 51 52 53 55
	56 57 58 5A 5B 5C 5E 5F
	60 61 63 64 65 67 68 69
	6A 6C 6D 6E 6F 71 72 73
	75 76 77 78 7A 7B 7C 7E
	7F 80 81 83 84 85 87 88
	89 8A 8C 8D 8E 90 91 92
	93 95 96 97 99 9A 9B 9C
	9D 9F A0 A1 A2 A4 A5 A6
	A7 A9 AA AB AC AE AF B0
	B1 B3 B4 B5 B6 B8 B9 BA
	BB BC BE BF C0 C1 C3 C4
	C5 C6 C8 C9 CA CB CD CE
	CF D0 D2 D3 D4 D5 D7 D8
	D9 DA DB DD DE DF E0 E2
	E3 E4 E5 E7 E8 E9 EA EC
	ED EE EF F1 F2 F3 F4 F6
    ];

    qcom,mdss-dsi-on-command-state = "dsi_lp_mode";
    qcom,mdss-dsi-off-command-state = "dsi_hs_mode";

    //qcom,esd-check-enabled;//esd
    /*qcom,panel-alive-reg-content = [
        0A 01 9C
        0B 01 00
        0D 01 00
        ];*/
    qcom,mdss-dsi-panel-status-command = [06 01 00 01 05 00 02 0A 08];
    qcom,mdss-dsi-panel-status-command-state = "dsi_lp_mode";
    qcom,mdss-dsi-panel-status-check-mode = "reg_read"; //esd

    qcom,mdss-dsi-h-sync-pulse = <1>;
    qcom,mdss-dsi-traffic-mode = "burst_mode";
    qcom,mdss-dsi-bllp-eof-power-mode;
    qcom,mdss-dsi-bllp-power-mode;
    qcom,mdss-dsi-lane-0-state;
    qcom,mdss-dsi-lane-1-state;
    qcom,mdss-dsi-lane-2-state;
    qcom,mdss-dsi-lane-3-state;
/******************te pin***************
	qcom,mdss-dsi-te-pin-select = <1>;
	qcom,mdss-dsi-wr-mem-start = <0x2c>;
	qcom,mdss-dsi-te-dcs-command = <1>;
	qcom,mdss-dsi-te-check-enable;
	qcom,mdss-dsi-te-using-te-pin;
******************te pin***************/
    qcom,mdss-dsi-panel-timings = [D2 43 3A 00 60 60 39 45 2C 03 04 00];
    qcom,mdss-dsi-t-clk-post = <0x1E>;
    qcom,mdss-dsi-t-clk-pre = <0x34>;
    qcom,mdss-dsi-bl-min-level = <1>;
    qcom,mdss-dsi-bl-max-level = <4095>;
    qcom,mdss-dsi-dma-trigger = "trigger_sw";
    qcom,mdss-dsi-mdp-trigger = "none";
    qcom,mdss-dsi-bl-pmic-control-type = "bl_ctrl_wled";
    qcom,mdss-dsi-reset-sequence = <1 10>, <0 10>, <1 20>;
    qcom,mdss-pan-physical-width-dimension = <68>;
    qcom,mdss-pan-physical-height-dimension = <121>;
    qcom,mdss-dsi-lp11-init;
    qcom,mdss-dsi-init-delay-us = <200>;
    qcom,mdss-dsi-avdd-avee-enabled;
    qcom,mdss-dsi-avdd-init-lcd-voltage = <5800000>;
    qcom,mdss-dsi-avee-init-lcd-voltage = <5800000>;
  };
};
