/* Copyright (c) 2013-2014, The Linux Foundation. All rights reserved.
 *
 * This program is free software; you can redistribute it and/or modify
 * it under the terms of the GNU General Public License version 2 and
 * only version 2 as published by the Free Software Foundation.
 *
 * This program is distributed in the hope that it will be useful,
 * but WITHOUT ANY WARRANTY; without even the implied warranty of
 * MERCHANTABILITY or FITNESS FOR A PARTICULAR PURPOSE.  See the
 * GNU General Public License for more details.
 */

/*---------------------------------------------------------------------------
 * This file is autogenerated file using gcdb parser. Please do not edit it.
 * Update input XML file to add a new entry or update variable in this file
 * VERSION = "1.0"
 *---------------------------------------------------------------------------*/
&mdss_mdp {
		dsi_sh1387_hehui_amoled_hd_vid: qcom,mdss_dsi_sh1387_hehui_amoled_hd_500 {
		qcom,mdss-dsi-panel-name = "LCD_TYPE_SH1387_HEHUI_AMOLED_HD_500";
		qcom,cont-splash-enabled;
		qcom,mdss-dsi-panel-controller = <&mdss_dsi0>;
		qcom,mdss-dsi-panel-type = "dsi_video_mode";
		qcom,mdss-dsi-panel-destination = "display_1";
		qcom,mdss-dsi-panel-framerate = <60>;
		qcom,mdss-dsi-virtual-channel-id = <0>;
		qcom,mdss-dsi-stream = <0>;
		qcom,mdss-dsi-panel-width = <720>;
		qcom,mdss-dsi-panel-height = <1280>;
		qcom,mdss-dsi-h-front-porch = <32>;
		qcom,mdss-dsi-h-back-porch = <243>;
		qcom,mdss-dsi-h-pulse-width = <16>;
		qcom,mdss-dsi-h-sync-skew = <0>;
		qcom,mdss-dsi-v-back-porch = <8>;
		qcom,mdss-dsi-v-front-porch = <32>;
		qcom,mdss-dsi-v-pulse-width = <4>;
		qcom,mdss-dsi-h-left-border = <0>;
		qcom,mdss-dsi-h-right-border = <0>;
		qcom,mdss-dsi-v-top-border = <0>;
		qcom,mdss-dsi-v-bottom-border = <0>;
		qcom,mdss-dsi-bpp = <24>;
		qcom,mdss-dsi-underflow-color = <0xff>;
		qcom,mdss-dsi-border-color = <0>;
		qcom,mdss-dsi-pixel-packing = <0>;
		qcom,mdss-dsi-on-command = [
			39 01 00 00 00 00 06 F0 55 AA 52 08 00
			39 01 00 00 00 00 04 E1 11 61 11
			39 01 00 00 00 00 05 B0 14 1E 30 20
			39 01 00 00 00 00 02 BA 03
			39 01 00 00 00 00 02 B6 04
			39 01 00 00 00 00 05 B7 04 04 06 04
			39 01 00 00 00 00 03 B8 00 00
			39 01 00 00 00 00 02 BB 24
			39 01 00 00 00 00 0A B4 00 55 AA 00 55 AA 00 55 AA
			39 01 00 00 00 00 0A B5 00 55 AA 00 55 AA 00 55 AA
			39 01 00 00 00 00 0C C0 00 00 06 07 08 09 00 00 00 00 00
			39 01 00 00 00 00 0C C1 02 00 0A 0B 0C 0D 00 00 00 00 00
			39 01 00 00 00 00 0C C2 21 0D 0D 00 01 00 00 00 00 00 00
			39 01 00 00 00 00 0C C3 A4 A8 3D 10 26 48 D3 44 A8 3D 00
			39 01 00 00 00 00 0A CC 0A 00 00 00 00 00 00 00 00
			39 01 00 00 00 00 0D CD 00 00 00 00 00 00 00 00 00 00 00 00
			39 01 00 00 00 00 0D C6 23 A5 1C 0D 07 31 21 A5 1C 0D 07 31
			39 01 00 00 00 00 0D C7 23 85 1C 14 00 11 22 85 1C 14 00 11
			39 01 00 00 00 00 0D C8 22 85 1C 0D 07 11 23 85 1C 0D 07 11
			39 01 00 00 00 00 0D C9 23 85 1C 14 00 11 22 85 1C 14 00 11
			39 01 00 00 00 00 06 F0 55 AA 52 08 01
			39 01 00 00 00 00 02 B5 1E
			39 01 00 00 00 00 02 B6 2D
			39 01 00 00 00 00 02 B7 04
			39 01 00 00 00 00 02 B8 05
			39 01 00 00 00 00 02 B9 04
			39 01 00 00 00 00 02 BA 14
			39 01 00 00 00 00 02 BB 2E
			39 01 00 00 00 00 02 BE 1C
			39 01 00 00 00 00 02 C1 55
			39 01 00 00 00 00 04 C2 00 55 07
			39 01 00 00 00 00 03 C3 11 0A
			39 01 00 00 00 00 07 D1 1F 2F 3F 4F 4F 9F
			39 01 00 00 00 00 0B D2 00 59 00 00 00 00 00 00 00 00
			39 01 00 00 00 00 04 D3 01 00 50
			39 01 00 00 00 00 06 F0 55 AA 52 08 02
			39 01 00 00 00 00 03 C1 00 00
			39 01 00 00 00 00 0D D1 1A 18 1C 00 00 00 1B 1B 00 00 00 00
			39 01 00 00 00 00 08 E0 00 F8 00 F0 00 E1 00
			39 01 00 00 00 00 03 E1 54 00
			39 01 00 00 00 00 03 E4 54 00
			39 01 00 00 00 00 03 E7 54 00
			05 01 00 00 78 00 02 11 00
			39 01 00 00 00 00 06 F0 55 AA 52 08 00
			39 01 00 00 00 00 04 E1 11 51 11
			39 01 00 00 00 00 02 C0 03
			39 01 00 00 00 00 06 F0 55 AA 52 08 02
			05 01 00 00 23 00 02 29 00
			];

		qcom,mdss-dsi-off-command = [05 01 00 00 32 00 02 28 00
				 05 01 00 00 78 00 02 10 00];
		qcom,panel-backlight-response-curve = [
			00 01 03 04 06 08 09 0B
			0C 0E 10 10 10 11 11 12
			12 13 13 14 14 15 15 16
			16 17 17 18 18 19 19 1A
			1A 1B 1B 1B 1C 1C 1D 1D
			1E 1E 1F 1F 20 20 21 21
			22 22 23 23 24 24 25 25
			26 26 26 27 27 28 28 29
			29 2A 2A 2B 2B 2C 2C 2D
			2D 2E 2E 2F 2F 30 30 31
			31 31 32 32 33 33 34 34
			35 35 36 36 37 37 38 38
			39 39 3A 3A 3B 3B 3C 3D
			3E 3F 41 42 43 45 46 47
			48 4A 4B 4C 4E 4F 50 52
			53 54 55 57 58 59 5B 5C
			5D 5E 60 61 62 64 65 66
			68 69 6A 6B 6D 6E 6F 71
			72 73 74 76 77 78 7A 7B
			7C 7E 7F 80 81 83 84 85
			87 88 89 8A 8C 8D 8E 90
			91 92 94 95 96 97 99 9A
			9B 9D 9E 9F A1 A2 A3 A4
			A6 A7 A8 A9 AB AC AD AE
			B0 B1 B2 B3 B5 B6 B7 B8
			BA BB BC BD BF C0 C1 C2
			C4 C5 C6 C7 C9 CA CB CC
			CE CF D0 D1 D3 D4 D5 D6
			D8 D9 DA DB DD DE DF E0
			E2 E3 E4 E5 E7 E8 E9 EA
			EC ED EE EF F1 F2 F3 F4
			F6 F7 F8 F9 FB FC FD FF
		];
		qcom,mdss-dsi-on-command-state = "dsi_lp_mode";
		qcom,mdss-dsi-off-command-state = "dsi_hs_mode";

		/*********************ESD*****************************
		qcom,esd-check-enabled;
		qcom,panel-alive-reg-content = [0A 01 9C];
		qcom,mdss-dsi-panel-status-command = [06 01 00 01 05 00 02 0A 08];
		qcom,mdss-dsi-panel-status-command-state = "dsi_lp_mode";
		qcom,mdss-dsi-panel-status-check-mode = "reg_read";
		*********************ESD*****************************/

		qcom,mdss-dsi-h-sync-pulse = <0>;
		qcom,mdss-dsi-traffic-mode = "burst_mode";
		qcom,mdss-dsi-bllp-eof-power-mode;
		qcom,mdss-dsi-bllp-power-mode;
		qcom,mdss-dsi-lane-0-state;
		qcom,mdss-dsi-lane-1-state;
		qcom,mdss-dsi-lane-2-state;
		qcom,mdss-dsi-lane-3-state;
		qcom,mdss-dsi-panel-timings = [8B 1E 14 00 44 60 18 20 19 03 04 00];  //MIPI SpeedRate:481.88M
		qcom,mdss-dsi-t-clk-post = <0x04>;
		qcom,mdss-dsi-t-clk-pre = <0x1C>;
		qcom,mdss-dsi-bl-min-level = <1>;
		qcom,mdss-dsi-bl-max-level = <255>;
		qcom,mdss-dsi-dma-trigger = "trigger_sw";
		qcom,mdss-dsi-mdp-trigger = "none";
		qcom,mdss-dsi-bl-pmic-control-type = "bl_ctrl_dcs";
		qcom,mdss-dsi-reset-sequence = <1 20>, <0 2>, <1 20>;
		qcom,mdss-pan-physical-width-dimension = <62>;
		qcom,mdss-pan-physical-height-dimension = <110>;
		qcom,mdss-dsi-lp11-init;
		qcom,mdss-dsi-force-clk-lane-hs;
		qcom,mdss-dsi-sh1387-brightness-enable;
		qcom,mdss-dsi-init-delay-us = <200>;
	};
};
