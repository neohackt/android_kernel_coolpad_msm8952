
qcom,CPLD-393lishen_3000mah {
	/* #2369325_Yulong_CPLD393lishen_3000mAh_averaged_MasterSlave_Apr4th2016*/
	qcom,max-voltage-uv = <4400000>;
	qcom,nom-batt-capacity-mah = <3000>;
	qcom,batt-id-kohm = <220>;
	qcom,battery-beta = <3435>;
	qcom,battery-type = "CPLD-393lishen_3000mah";
	qcom,chg-rslow-comp-c1 = <3303437>;
	qcom,chg-rslow-comp-c2 = <5492573>;
	qcom,chg-rs-to-rslow = <1117583>;
	qcom,chg-rslow-comp-thr = <0xB2>;
	qcom,checksum = <0xFCD7>;
	qcom,gui-version = "PMI8950GUI - 2.0.0.15";
	qcom,fg-profile-data = [
		 FB 83 E8 7D 
		 FA 81 7D 7C 
		 5C 83 F3 67 
		 5E 83 E4 8D 
		 24 82 14 9A 
		 25 BD EF C9 
		 5B 0E 0A 88 
		 5C 7E 39 82 
		 AD 7C 58 83 
		 A4 63 9A 7B 
		 1A 8C 53 82 
		 B4 99 17 BD 
		 1E CA 5A 0E 
		 26 0C 83 59 
		 14 70 B2 FD 
		 49 44 A3 45 
		 DE 43 00 00 
		 84 46 5C 32 
		 FD 26 00 00 
		 00 00 00 00 
		 00 00 00 00 
		 6C 71 60 70 
		 4C 6A E8 89 
		 C9 76 40 6B 
		 88 5C 1C 80 
		 A2 74 2C 68 
		 50 6F 51 B0 
		 17 ED 61 43 
		 64 A0 71 0C 
		 28 00 FF 36 
		 F0 11 30 03 
		 00 00 00 0C 
	];
};
