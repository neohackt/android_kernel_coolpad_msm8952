/* Copyright (c) 2014, The Linux Foundation. All rights reserved.
 *
 * This program is free software; you can redistribute it and/or modify
 * it under the terms of the GNU General Public License version 2 and
 * only version 2 as published by the Free Software Foundation.
 *
 * This program is distributed in the hope that it will be useful,
 * but WITHOUT ANY WARRANTY; without even the implied warranty of
 * MERCHANTABILITY or FITNESS FOR A PARTICULAR PURPOSE.  See the
 * GNU General Public License for more details.
 */

/*---------------------------------------------------------------------------
 * This file is autogenerated file using gcdb parser. Please do not edit it.
 * Update input XML file to add a new entry or update variable in this file
 * VERSION = "1.0"
 *---------------------------------------------------------------------------*/

&mdss_mdp {
    dsi_nt35695_sharp_fhd_vid: qcom,mdss_dsi_nt35695_sharp_fhd_video {
    qcom,cont-splash-enabled;
    qcom,mdss-dsi-panel-name = "LCD_TYPE_NT35695_SHARP_FHD";
    qcom,mdss-dsi-panel-controller = <&mdss_dsi0>;
    qcom,mdss-dsi-panel-type = "dsi_cmd_mode";
    qcom,mdss-dsi-panel-destination = "display_1";
    qcom,mdss-dsi-panel-framerate = <60>;
    qcom,mdss-dsi-virtual-channel-id = <0>;
    qcom,mdss-dsi-stream = <0>;
    qcom,mdss-dsi-panel-width = <1080>;
    qcom,mdss-dsi-panel-height = <1920>;
    qcom,mdss-dsi-h-front-porch = <96>;
    qcom,mdss-dsi-h-back-porch = <45>;
    qcom,mdss-dsi-h-pulse-width = <15>;
    qcom,mdss-dsi-h-sync-skew = <0>;
    qcom,mdss-dsi-v-front-porch = <4>;
    qcom,mdss-dsi-v-back-porch = <2>;
    qcom,mdss-dsi-v-pulse-width = <2>;
    qcom,mdss-dsi-h-left-border = <0>;
    qcom,mdss-dsi-h-right-border = <0>;
    qcom,mdss-dsi-v-top-border = <0>;
    qcom,mdss-dsi-v-bottom-border = <0>;
    qcom,mdss-dsi-bpp = <24>;
    qcom,mdss-dsi-underflow-color = <0xff>;
    qcom,mdss-dsi-border-color = <0>;
    qcom,mdss-dsi-pixel-packing = <0>;
    qcom,mdss-dsi-on-command = [
	39 01 00 00 00 00 02 FF 20
	39 01 00 00 00 00 02 FB 01
	39 01 00 00 00 00 02 75 00
	39 01 00 00 00 00 02 76 1C
	39 01 00 00 00 00 02 77 00
	39 01 00 00 00 00 02 78 3C
	39 01 00 00 00 00 02 79 00
	39 01 00 00 00 00 02 7A 6B
	39 01 00 00 00 00 02 7B 00
	39 01 00 00 00 00 02 7C 8C
	39 01 00 00 00 00 02 7D 00
	39 01 00 00 00 00 02 7E AC
	39 01 00 00 00 00 02 7F 00
	39 01 00 00 00 00 02 80 C4
	39 01 00 00 00 00 02 81 00
	39 01 00 00 00 00 02 82 DC
	39 01 00 00 00 00 02 83 00
	39 01 00 00 00 00 02 84 ED
	39 01 00 00 00 00 02 85 01
	39 01 00 00 00 00 02 86 00
	39 01 00 00 00 00 02 87 01
	39 01 00 00 00 00 02 88 36
	39 01 00 00 00 00 02 89 01
	39 01 00 00 00 00 02 8A 62
	39 01 00 00 00 00 02 8B 01
	39 01 00 00 00 00 02 8C A2
	39 01 00 00 00 00 02 8D 01
	39 01 00 00 00 00 02 8E D1
	39 01 00 00 00 00 02 8F 02
	39 01 00 00 00 00 02 90 18
	39 01 00 00 00 00 02 91 02
	39 01 00 00 00 00 02 92 4D
	39 01 00 00 00 00 02 93 02
	39 01 00 00 00 00 02 94 4E
	39 01 00 00 00 00 02 95 02
	39 01 00 00 00 00 02 96 80
	39 01 00 00 00 00 02 97 02
	39 01 00 00 00 00 02 98 C1
	39 01 00 00 00 00 02 99 02
	39 01 00 00 00 00 02 9A EB
	39 01 00 00 00 00 02 9B 03
	39 01 00 00 00 00 02 9C 21
	39 01 00 00 00 00 02 9D 03
	39 01 00 00 00 00 02 9E 3B
	39 01 00 00 00 00 02 9F 03
	39 01 00 00 00 00 02 A0 5F
	39 01 00 00 00 00 02 A2 03
	39 01 00 00 00 00 02 A3 6A
	39 01 00 00 00 00 02 A4 03
	39 01 00 00 00 00 02 A5 71
	39 01 00 00 00 00 02 A6 03
	39 01 00 00 00 00 02 A7 80
	39 01 00 00 00 00 02 A9 03
	39 01 00 00 00 00 02 AA 92
	39 01 00 00 00 00 02 AB 03
	39 01 00 00 00 00 02 AC A6
	39 01 00 00 00 00 02 AD 03
	39 01 00 00 00 00 02 AE BA
	39 01 00 00 00 00 02 AF 03
	39 01 00 00 00 00 02 B0 CB
	39 01 00 00 00 00 02 B1 03
	39 01 00 00 00 00 02 B2 CD
	39 01 00 00 00 00 02 B3 00
	39 01 00 00 00 00 02 B4 65
	39 01 00 00 00 00 02 B5 00
	39 01 00 00 00 00 02 B6 83
	39 01 00 00 00 00 02 B7 00
	39 01 00 00 00 00 02 B8 B2
	39 01 00 00 00 00 02 B9 00
	39 01 00 00 00 00 02 BA D3
	39 01 00 00 00 00 02 BB 00
	39 01 00 00 00 00 02 BC F2
	39 01 00 00 00 00 02 BD 01
	39 01 00 00 00 00 02 BE 09
	39 01 00 00 00 00 02 BF 01
	39 01 00 00 00 00 02 C0 21
	39 01 00 00 00 00 02 C1 01
	39 01 00 00 00 00 02 C2 31
	39 01 00 00 00 00 02 C3 01
	39 01 00 00 00 00 02 C4 43
	39 01 00 00 00 00 02 C5 01
	39 01 00 00 00 00 02 C6 77
	39 01 00 00 00 00 02 C7 01
	39 01 00 00 00 00 02 C8 A1
	39 01 00 00 00 00 02 C9 01
	39 01 00 00 00 00 02 CA DC
	39 01 00 00 00 00 02 CB 02
	39 01 00 00 00 00 02 CC 06
	39 01 00 00 00 00 02 CD 02
	39 01 00 00 00 00 02 CE 47
	39 01 00 00 00 00 02 CF 02
	39 01 00 00 00 00 02 D0 7C
	39 01 00 00 00 00 02 D1 02
	39 01 00 00 00 00 02 D2 7D
	39 01 00 00 00 00 02 D3 02
	39 01 00 00 00 00 02 D4 AF
	39 01 00 00 00 00 02 D5 02
	39 01 00 00 00 00 02 D6 DC
	39 01 00 00 00 00 02 D7 02
	39 01 00 00 00 00 02 D8 F6
	39 01 00 00 00 00 02 D9 03
	39 01 00 00 00 00 02 DA 1C
	39 01 00 00 00 00 02 DB 03
	39 01 00 00 00 00 02 DC 38
	39 01 00 00 00 00 02 DD 03
	39 01 00 00 00 00 02 DE 5C
	39 01 00 00 00 00 02 DF 03
	39 01 00 00 00 00 02 E0 68
	39 01 00 00 00 00 02 E1 03
	39 01 00 00 00 00 02 E2 70
	39 01 00 00 00 00 02 E3 03
	39 01 00 00 00 00 02 E4 7F
	39 01 00 00 00 00 02 E5 03
	39 01 00 00 00 00 02 E6 91
	39 01 00 00 00 00 02 E7 03
	39 01 00 00 00 00 02 E8 A5
	39 01 00 00 00 00 02 E9 03
	39 01 00 00 00 00 02 EA B9
	39 01 00 00 00 00 02 EB 03
	39 01 00 00 00 00 02 EC CA
	39 01 00 00 00 00 02 ED 03
	39 01 00 00 00 00 02 EE CD
	39 01 00 00 00 00 02 EF 00
	39 01 00 00 00 00 02 F0 F1
	39 01 00 00 00 00 02 F1 00
	39 01 00 00 00 00 02 F2 FB
	39 01 00 00 00 00 02 F3 01
	39 01 00 00 00 00 02 F4 0B
	39 01 00 00 00 00 02 F5 01
	39 01 00 00 00 00 02 F6 1A
	39 01 00 00 00 00 02 F7 01
	39 01 00 00 00 00 02 F8 29
	39 01 00 00 00 00 02 F9 01
	39 01 00 00 00 00 02 FA 36
	39 01 00 00 00 00 02 FF 21
	39 01 00 00 00 00 02 FB 01
	39 01 00 00 00 00 02 00 01
	39 01 00 00 00 00 02 01 41
	39 01 00 00 00 00 02 02 01
	39 01 00 00 00 00 02 03 4C
	39 01 00 00 00 00 02 04 01
	39 01 00 00 00 00 02 05 57
	39 01 00 00 00 00 02 06 01
	39 01 00 00 00 00 02 07 7B
	39 01 00 00 00 00 02 08 01
	39 01 00 00 00 00 02 09 99
	39 01 00 00 00 00 02 0A 01
	39 01 00 00 00 00 02 0B C8
	39 01 00 00 00 00 02 0C 01
	39 01 00 00 00 00 02 0D ED
	39 01 00 00 00 00 02 0E 02
	39 01 00 00 00 00 02 0F 28
	39 01 00 00 00 00 02 10 02
	39 01 00 00 00 00 02 11 59
	39 01 00 00 00 00 02 12 02
	39 01 00 00 00 00 02 13 5A
	39 01 00 00 00 00 02 14 02
	39 01 00 00 00 00 02 15 89
	39 01 00 00 00 00 02 16 02
	39 01 00 00 00 00 02 17 C9
	39 01 00 00 00 00 02 18 02
	39 01 00 00 00 00 02 19 F3
	39 01 00 00 00 00 02 1A 03
	39 01 00 00 00 00 02 1B 28
	39 01 00 00 00 00 02 1C 03
	39 01 00 00 00 00 02 1D 43
	39 01 00 00 00 00 02 1E 03
	39 01 00 00 00 00 02 1F 68
	39 01 00 00 00 00 02 20 03
	39 01 00 00 00 00 02 21 73
	39 01 00 00 00 00 02 22 03
	39 01 00 00 00 00 02 23 7E
	39 01 00 00 00 00 02 24 03
	39 01 00 00 00 00 02 25 8B
	39 01 00 00 00 00 02 26 03
	39 01 00 00 00 00 02 27 9A
	39 01 00 00 00 00 02 28 03
	39 01 00 00 00 00 02 29 AB
	39 01 00 00 00 00 02 2A 03
	39 01 00 00 00 00 02 2B BE
	39 01 00 00 00 00 02 2D 03
	39 01 00 00 00 00 02 2F CA
	39 01 00 00 00 00 02 30 03
	39 01 00 00 00 00 02 31 CD
	39 01 00 00 00 00 02 32 01
	39 01 00 00 00 00 02 33 20
	39 01 00 00 00 00 02 34 01
	39 01 00 00 00 00 02 35 2A
	39 01 00 00 00 00 02 36 01
	39 01 00 00 00 00 02 37 3A
	39 01 00 00 00 00 02 38 01
	39 01 00 00 00 00 02 39 49
	39 01 00 00 00 00 02 3A 01
	39 01 00 00 00 00 02 3B 58
	39 01 00 00 00 00 02 3D 01
	39 01 00 00 00 00 02 3F 65
	39 01 00 00 00 00 02 40 01
	39 01 00 00 00 00 02 41 70
	39 01 00 00 00 00 02 42 01
	39 01 00 00 00 00 02 43 7B
	39 01 00 00 00 00 02 44 01
	39 01 00 00 00 00 02 45 86
	39 01 00 00 00 00 02 46 01
	39 01 00 00 00 00 02 47 AA
	39 01 00 00 00 00 02 48 01
	39 01 00 00 00 00 02 49 C8
	39 01 00 00 00 00 02 4A 01
	39 01 00 00 00 00 02 4B F7
	39 01 00 00 00 00 02 4C 02
	39 01 00 00 00 00 02 4D 1C
	39 01 00 00 00 00 02 4E 02
	39 01 00 00 00 00 02 4F 57
	39 01 00 00 00 00 02 50 02
	39 01 00 00 00 00 02 51 88
	39 01 00 00 00 00 02 52 02
	39 01 00 00 00 00 02 53 89
	39 01 00 00 00 00 02 54 02
	39 01 00 00 00 00 02 55 B8
	39 01 00 00 00 00 02 56 02
	39 01 00 00 00 00 02 58 E4
	39 01 00 00 00 00 02 59 02
	39 01 00 00 00 00 02 5A FE
	39 01 00 00 00 00 02 5B 03
	39 01 00 00 00 00 02 5C 23
	39 01 00 00 00 00 02 5D 03
	39 01 00 00 00 00 02 5E 40
	39 01 00 00 00 00 02 5F 03
	39 01 00 00 00 00 02 60 65
	39 01 00 00 00 00 02 61 03
	39 01 00 00 00 00 02 62 70
	39 01 00 00 00 00 02 63 03
	39 01 00 00 00 00 02 64 7D
	39 01 00 00 00 00 02 65 03
	39 01 00 00 00 00 02 66 8A
	39 01 00 00 00 00 02 67 03
	39 01 00 00 00 00 02 68 99
	39 01 00 00 00 00 02 69 03
	39 01 00 00 00 00 02 6A AA
	39 01 00 00 00 00 02 6B 03
	39 01 00 00 00 00 02 6C BD
	39 01 00 00 00 00 02 6D 03
	39 01 00 00 00 00 02 6E C9
	39 01 00 00 00 00 02 6F 03
	39 01 00 00 00 00 02 70 CD
	39 01 00 00 00 00 02 71 00
	39 01 00 00 00 00 02 72 ED
	39 01 00 00 00 00 02 73 00
	39 01 00 00 00 00 02 74 F8
	39 01 00 00 00 00 02 75 01
	39 01 00 00 00 00 02 76 0A
	39 01 00 00 00 00 02 77 01
	39 01 00 00 00 00 02 78 19
	39 01 00 00 00 00 02 79 01
	39 01 00 00 00 00 02 7A 28
	39 01 00 00 00 00 02 7B 01
	39 01 00 00 00 00 02 7C 36
	39 01 00 00 00 00 02 7D 01
	39 01 00 00 00 00 02 7E 43
	39 01 00 00 00 00 02 7F 01
	39 01 00 00 00 00 02 80 4D
	39 01 00 00 00 00 02 81 01
	39 01 00 00 00 00 02 82 58
	39 01 00 00 00 00 02 83 01
	39 01 00 00 00 00 02 84 7B
	39 01 00 00 00 00 02 85 01
	39 01 00 00 00 00 02 86 9A
	39 01 00 00 00 00 02 87 01
	39 01 00 00 00 00 02 88 CA
	39 01 00 00 00 00 02 89 01
	39 01 00 00 00 00 02 8A EE
	39 01 00 00 00 00 02 8B 02
	39 01 00 00 00 00 02 8C 29
	39 01 00 00 00 00 02 8D 02
	39 01 00 00 00 00 02 8E 59
	39 01 00 00 00 00 02 8F 02
	39 01 00 00 00 00 02 90 5A
	39 01 00 00 00 00 02 91 02
	39 01 00 00 00 00 02 92 89
	39 01 00 00 00 00 02 93 02
	39 01 00 00 00 00 02 94 C9
	39 01 00 00 00 00 02 95 02
	39 01 00 00 00 00 02 96 F3
	39 01 00 00 00 00 02 97 03
	39 01 00 00 00 00 02 98 2A
	39 01 00 00 00 00 02 99 03
	39 01 00 00 00 00 02 9A 46
	39 01 00 00 00 00 02 9B 03
	39 01 00 00 00 00 02 9C 71
	39 01 00 00 00 00 02 9D 03
	39 01 00 00 00 00 02 9E 80
	39 01 00 00 00 00 02 9F 03
	39 01 00 00 00 00 02 A0 8F
	39 01 00 00 00 00 02 A2 03
	39 01 00 00 00 00 02 A3 9F
	39 01 00 00 00 00 02 A4 03
	39 01 00 00 00 00 02 A5 AA
	39 01 00 00 00 00 02 A6 03
	39 01 00 00 00 00 02 A7 B0
	39 01 00 00 00 00 02 A9 03
	39 01 00 00 00 00 02 AA C0
	39 01 00 00 00 00 02 AB 03
	39 01 00 00 00 00 02 AC C9
	39 01 00 00 00 00 02 AD 03
	39 01 00 00 00 00 02 AE CD
	39 01 00 00 00 00 02 AF 01
	39 01 00 00 00 00 02 B0 1C
	39 01 00 00 00 00 02 B1 01
	39 01 00 00 00 00 02 B2 27
	39 01 00 00 00 00 02 B3 01
	39 01 00 00 00 00 02 B4 39
	39 01 00 00 00 00 02 B5 01
	39 01 00 00 00 00 02 B6 48
	39 01 00 00 00 00 02 B7 01
	39 01 00 00 00 00 02 B8 57
	39 01 00 00 00 00 02 B9 01
	39 01 00 00 00 00 02 BA 65
	39 01 00 00 00 00 02 BB 01
	39 01 00 00 00 00 02 BC 72
	39 01 00 00 00 00 02 BD 01
	39 01 00 00 00 00 02 BE 7C
	39 01 00 00 00 00 02 BF 01
	39 01 00 00 00 00 02 C0 87
	39 01 00 00 00 00 02 C1 01
	39 01 00 00 00 00 02 C2 AA
	39 01 00 00 00 00 02 C3 01
	39 01 00 00 00 00 02 C4 C9
	39 01 00 00 00 00 02 C5 01
	39 01 00 00 00 00 02 C6 F9
	39 01 00 00 00 00 02 C7 02
	39 01 00 00 00 00 02 C8 1D
	39 01 00 00 00 00 02 C9 02
	39 01 00 00 00 00 02 CA 58
	39 01 00 00 00 00 02 CB 02
	39 01 00 00 00 00 02 CC 88
	39 01 00 00 00 00 02 CD 02
	39 01 00 00 00 00 02 CE 89
	39 01 00 00 00 00 02 CF 02
	39 01 00 00 00 00 02 D0 B8
	39 01 00 00 00 00 02 D1 02
	39 01 00 00 00 00 02 D2 E4
	39 01 00 00 00 00 02 D3 02
	39 01 00 00 00 00 02 D4 FE
	39 01 00 00 00 00 02 D5 03
	39 01 00 00 00 00 02 D6 25
	39 01 00 00 00 00 02 D7 03
	39 01 00 00 00 00 02 D8 43
	39 01 00 00 00 00 02 D9 03
	39 01 00 00 00 00 02 DA 6E
	39 01 00 00 00 00 02 DB 03
	39 01 00 00 00 00 02 DC 7E
	39 01 00 00 00 00 02 DD 03
	39 01 00 00 00 00 02 DE 8E
	39 01 00 00 00 00 02 DF 03
	39 01 00 00 00 00 02 E0 9E
	39 01 00 00 00 00 02 E1 03
	39 01 00 00 00 00 02 E2 A9
	39 01 00 00 00 00 02 E3 03
	39 01 00 00 00 00 02 E4 AF
	39 01 00 00 00 00 02 E5 03
	39 01 00 00 00 00 02 E6 BF
	39 01 00 00 00 00 02 E7 03
	39 01 00 00 00 00 02 E8 C8
	39 01 00 00 00 00 02 E9 03
	39 01 00 00 00 00 02 EA CD

	39 01 00 00 00 00 02 FF 23
	39 01 00 00 00 00 02 FB 01
	39 01 00 00 00 00 02 08 04
	39 01 00 00 00 00 02 FF 10
	39 01 00 00 00 00 02 BB 10
	39 01 00 00 00 00 02 51 00
	39 01 00 00 00 00 02 53 24
	39 01 00 00 00 00 02 35 00
	39 01 00 00 00 00 03 44 05 00
	05 01 00 00 78 00 02 11 00
	05 01 00 00 14 00 02 29 00
	];
    qcom,mdss-dsi-off-command = [
		/**************************
		39 01 00 00 00 00 02 FF 24
		39 01 00 00 00 00 02 FB 01
		39 01 00 00 00 00 02 6E 10
		**************************/
		39 01 00 00 00 00 02 FF 10

		05 01 00 00 14 00 02 28 00
		05 01 00 00 78 00 02 10 00
		39 01 00 00 78 00 02 4F 01
         ];
    qcom,panel-backlight-response-curve = [
	00 01 01 01 02 02 02 02
	03 03 03 03 04 04 05 05
	06 06 07 07 08 08 09 0A
	0A 0B 0B 0C 0C 0D 0D 0E
	0E 0F 10 10 11 11 12 12
	13 13 14 14 15 16 16 17
	17 18 18 19 19 1A 1A 1B
	1C 1C 1D 1D 1E 1E 1F 1F
	20 20 21 21 22 23 23 24
	24 25 25 26 26 27 27 28
	29 29 2A 2A 2B 2B 2C 2C
	2D 2D 2E 2F 2F 30 30 31
	31 32 32 33 33 34 35 36
	37 38 3A 3B 3C 3D 3F 40
	41 43 44 45 46 48 49 4A
	4C 4D 4E 4F 51 52 53 55
	56 57 58 5A 5B 5C 5E 5F
	60 61 63 64 65 67 68 69
	6A 6C 6D 6E 6F 71 72 73
	75 76 77 78 7A 7B 7C 7E
	7F 80 81 83 84 85 87 88
	89 8A 8C 8D 8E 90 91 92
	93 95 96 97 99 9A 9B 9C
	9D 9F A0 A1 A2 A4 A5 A6
	A7 A9 AA AB AC AE AF B0
	B1 B3 B4 B5 B6 B8 B9 BA
	BB BC BE BF C0 C1 C3 C4
	C5 C6 C8 C9 CA CB CD CE
	CF D0 D2 D3 D4 D5 D7 D8
	D9 DA DB DD DE DF E0 E2
	E3 E4 E5 E7 E8 E9 EA EC
	ED EE EF F1 F2 F3 F4 F6
    ];

    qcom,mdss-dsi-on-command-state = "dsi_lp_mode";
    qcom,mdss-dsi-off-command-state = "dsi_hs_mode";

    //qcom,esd-check-enabled;//esd
    /*qcom,panel-alive-reg-content = [
        0A 01 9C
        0B 01 00
        0D 01 00
        ];*/
    qcom,mdss-dsi-panel-status-command = [06 01 00 01 05 00 02 0A 08];
    qcom,mdss-dsi-panel-status-command-state = "dsi_lp_mode";
    qcom,mdss-dsi-panel-status-check-mode = "reg_read"; //esd

    //qcom,mdss-dsi-h-sync-pulse = <1>;
    qcom,mdss-dsi-traffic-mode = "burst_mode";
    qcom,mdss-dsi-bllp-eof-power-mode;
    qcom,mdss-dsi-bllp-power-mode;
    qcom,mdss-dsi-lane-0-state;
    qcom,mdss-dsi-lane-1-state;
    qcom,mdss-dsi-lane-2-state;
    qcom,mdss-dsi-lane-3-state;
/******************te pin***************/
		qcom,mdss-dsi-te-pin-select = <1>;
		qcom,mdss-dsi-wr-mem-start = <0x2c>;
		qcom,mdss-dsi-te-dcs-command = <1>;
		qcom,mdss-dsi-te-check-enable;
		qcom,mdss-dsi-te-using-te-pin;
/******************te pin***************/
    qcom,mdss-dsi-panel-timings = [F7 41 38 00 5B 60 37 43 59 03 04 00];
    qcom,mdss-dsi-t-clk-post = <0x1E>;
    qcom,mdss-dsi-t-clk-pre = <0x39>;
    qcom,mdss-dsi-bl-min-level = <1>;
    qcom,mdss-dsi-bl-max-level = <4095>;
    qcom,mdss-dsi-dma-trigger = "trigger_sw";
    qcom,mdss-dsi-mdp-trigger = "none";
    qcom,mdss-dsi-bl-pmic-control-type = "bl_ctrl_wled";
    qcom,mdss-dsi-reset-sequence = <1 6>, <0 6>, <1 12>;
    qcom,mdss-pan-physical-width-dimension = <68>;
    qcom,mdss-pan-physical-height-dimension = <121>;
    qcom,mdss-dsi-lp11-init;
    qcom,mdss-dsi-init-delay-us = <200>;
    qcom,mdss-dsi-avdd-avee-enabled;
    qcom,mdss-dsi-avdd-init-lcd-voltage = <5800000>;
    qcom,mdss-dsi-avee-init-lcd-voltage = <5800000>;
  };
};
