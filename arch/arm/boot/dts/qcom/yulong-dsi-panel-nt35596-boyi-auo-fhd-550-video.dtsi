/* Copyright (c) 2014, The Linux Foundation. All rights reserved.
 *
 * This program is free software; you can redistribute it and/or modify
 * it under the terms of the GNU General Public License version 2 and
 * only version 2 as published by the Free Software Foundation.
 *
 * This program is distributed in the hope that it will be useful,
 * but WITHOUT ANY WARRANTY; without even the implied warranty of
 * MERCHANTABILITY or FITNESS FOR A PARTICULAR PURPOSE.  See the
 * GNU General Public License for more details.
 */

/*---------------------------------------------------------------------------
 * This file is autogenerated file using gcdb parser. Please do not edit it.
 * Update input XML file to add a new entry or update variable in this file
 * VERSION = "1.0"
 *---------------------------------------------------------------------------*/

&mdss_mdp {
	dsi_nt35596_boyi_auo_fhd_vid: qcom,mdss_dsi_nt35596_boyi_auo_fhd_video {
		qcom,cont-splash-enabled;
		qcom,mdss-dsi-panel-name = "LCD_TYPE_NT35596_BOYI_AUO_FHD_550";
		qcom,mdss-dsi-panel-type = "dsi_video_mode";
		qcom,mdss-dsi-panel-framerate = <60>;
		qcom,mdss-dsi-virtual-channel-id = <0>;
		qcom,mdss-dsi-stream = <0>;
		qcom,mdss-dsi-panel-width = <1080>;
		qcom,mdss-dsi-panel-height = <1920>;
		qcom,mdss-dsi-h-front-porch = <48>;
		qcom,mdss-dsi-h-back-porch = <18>;
		qcom,mdss-dsi-h-pulse-width = <10>;
		qcom,mdss-dsi-h-sync-skew = <0>;
		qcom,mdss-dsi-v-back-porch = <6>;
		qcom,mdss-dsi-v-front-porch = <6>;
		qcom,mdss-dsi-v-pulse-width = <2>;
		qcom,mdss-dsi-h-left-border = <0>;
		qcom,mdss-dsi-h-right-border = <0>;
		qcom,mdss-dsi-v-top-border = <0>;
		qcom,mdss-dsi-v-bottom-border = <0>;
		qcom,mdss-dsi-bpp = <24>;
		qcom,mdss-dsi-underflow-color = <0xff>;
		qcom,mdss-dsi-border-color = <0>;
		qcom,mdss-dsi-pixel-packing = <0>;
		qcom,mdss-dsi-on-command = [
                        39 01 00 00 00 00 02 FF EE
                        39 01 00 00 00 00 02 FB 01
                        39 01 00 00 0A 00 02 18 40
                        39 01 00 00 0A 00 02 18 00
                        39 01 00 00 00 00 02 FF 05
                        39 01 00 00 00 00 02 C5 31
                        39 01 00 00 14 00 02 FB 01
                        39 01 00 00 00 00 02 FF EE
                        39 01 00 00 00 00 02 7C 31
                        39 01 00 00 00 00 02 25 01
                        39 01 00 00 00 00 02 FB 01
                        39 01 00 00 00 00 02 FF 01
                        39 01 00 00 00 00 02 FB 01
                        39 01 00 00 00 00 02 0B 9B
                        39 01 00 00 00 00 02 0C 9B
                        39 01 00 00 00 00 02 5A 02
                        39 01 00 00 00 00 02 06 4A
                        39 01 00 00 00 00 02 FF 05
                        39 01 00 00 00 00 02 FB 01
                        39 01 00 00 00 00 02 05 0F
                        39 01 00 00 00 00 02 06 10
                        39 01 00 00 00 00 02 07 00
                        39 01 00 00 00 00 02 15 0F
                        39 01 00 00 00 00 02 16 10
                        39 01 00 00 00 00 02 23 36
                        39 01 00 00 00 00 02 24 36
                        39 01 00 00 00 00 02 4D 00
                        39 01 00 00 00 00 02 4E 00
                        39 01 00 00 00 00 02 4F 11
                        39 01 00 00 00 00 02 50 11
                        39 01 00 00 00 00 02 53 01
                        39 01 00 00 00 00 02 54 75
                        39 01 00 00 00 00 02 7E 0A
                        39 01 00 00 00 00 02 7F 1A
                        39 01 00 00 00 00 02 8A 33
                        39 01 00 00 00 00 02 9B 0F
                        39 01 00 00 00 00 02 A4 0F
                        39 01 00 00 00 00 02 E7 80
                        39 01 00 00 00 00 02 FB 01
                        39 01 00 00 00 00 02 FF 00
                        39 01 00 00 00 00 02 FB 01
                        39 01 00 00 00 00 02 D3 08
                        39 01 00 00 00 00 02 D4 06
                        39 01 00 00 00 00 02 FF 00
                        05 01 00 00 78 00 02 11 00
                        05 01 00 00 14 00 02 29 00
			];
		qcom,mdss-dsi-off-command = [05 01 00 00 32 00 02 28 00
				 05 01 00 00 78 00 02 10 00];
		qcom,panel-ce-cmds = [
				29 01 00 00 00 00 02 55 93
				];
		qcom,panel-ce-off-cmds = [
				29 01 00 00 00 00 02 55 03
				];
		qcom,panel-ce-level1-cmds = [
				29 01 00 00 00 00 02 55 83
				];
		qcom,panel-ce-level2-cmds = [
				29 01 00 00 00 00 02 55 93
				];
		qcom,panel-ce-level3-cmds = [
				29 01 00 00 00 00 02 55 B3
				];
		qcom,panel-cabc-ui-cmds = [
				29 01 00 00 00 00 02 55 91
				];
		qcom,panel-cabc-still-cmds = [
				29 01 00 00 00 00 02 55 92
				];
		qcom,panel-cabc-moving-cmds = [
				29 01 00 00 00 00 02 55 93
				];
		qcom,panel-cabc-off-cmds = [
				29 01 00 00 00 00 02 55 00
				];
		qcom,panel-backlight-response-curve = [
			00 02 04 04 06 06 06 06
			06 06 06 06 0A 0A 0D 0D
			0D 0D 0D 0E 0E 0E 0F 0F
			0F 0F 0F 10 10 10 10 11
			11 11 11 12 12 12 12 13
			13 13 13 14 14 14 15 15
			15 16 16 16 17 18 18 19
			1A 1B 1B 1C 1D 1D 1E 1F
			21 21 21 22 23 23 24 25
			26 26 27 27 28 28 29 29
			2A 2A 2B 2B 2C 2C 2D 2D
			2E 2E 2F 2F 30 30 31 31
			31 32 32 33 33 33 34 34
			34 35 37 38 3A 3B 3D 3E
			3F 40 41 42 43 44 45 46
			47 48 49 4A 4B 4C 4D 4E
			4F 50 51 51 52 53 54 54
			55 56 57 57 58 59 5A 5B
			5C 5E 5F 61 62 64 65 67
			68 6A 6B 6C 6E 6F 71 72
			74 75 77 78 7A 7B 7D 7E
			7F 81 82 84 85 87 89 8B
			8C 8D 8E 90 91 92 94 95
			97 98 9A 9B 9D 9E A0 A1
			A3 A4 A5 A7 A8 AA AB AD
			AE AF B1 B3 B4 B5 B7 B8
			BA BB BD BE BF C1 C4 C5
			C7 C8 C9 CA CB CD CE D0
			D1 D3 D4 D6 D7 D9 DA DB
			DD DE E0 E1 E3 E4 E6 E7
			E9 EA EC ED EE F0 F1 F3
			F4 F6 F7 F9 FA FC FD FF
		];
		qcom,mdss-dsi-on-command-state = "dsi_lp_mode";
		qcom,mdss-dsi-off-command-state = "dsi_lp_mode";
		qcom,esd-check-enabled;								//esd
		qcom,panel-alive-reg-content = [
				0A 01 9C
				0B 01 00
				0D 01 00
				];
		qcom,mdss-dsi-panel-status-command = [06 01 00 01 05 00 02 0A 08];
		qcom,mdss-dsi-panel-status-command-state = "dsi_lp_mode";
		qcom,mdss-dsi-panel-status-check-mode = "reg_read";		//esd
		qcom,mdss-dsi-h-sync-pulse = <1>;
		qcom,mdss-dsi-traffic-mode = "burst_mode";
		qcom,mdss-dsi-bllp-eof-power-mode;
		qcom,mdss-dsi-bllp-power-mode;
		qcom,mdss-dsi-lane-0-state;
		qcom,mdss-dsi-lane-1-state;
		qcom,mdss-dsi-lane-2-state;
		qcom,mdss-dsi-lane-3-state;
		qcom,mdss-dsi-panel-timings = [36 32 22 00 60 66 26 36 28 03 04 00];
		qcom,mdss-dsi-t-clk-post = <0x03>;
		qcom,mdss-dsi-t-clk-pre = <0x22>;
		qcom,mdss-dsi-bl-min-level = <1>;
		qcom,mdss-dsi-bl-max-level = <4095>;
		qcom,mdss-dsi-dma-trigger = "trigger_sw";
		qcom,mdss-dsi-mdp-trigger = "none";
		qcom,mdss-dsi-bl-pmic-control-type = "bl_ctrl_wled";
		qcom,mdss-dsi-reset-sequence = <1 20>, <0 10>, <1 20>;
		qcom,mdss-pan-physical-width-dimension = <68>;
		qcom,mdss-pan-physical-height-dimension = <121>;
		qcom,mdss-dsi-lp11-init;
		qcom,mdss-dsi-init-delay-us = <200>;
		qcom,mdss-dsi-avdd-avee-enabled;
		qcom,mdss-dsi-avdd-init-lcd-voltage = <6000000>;
		qcom,mdss-dsi-avee-init-lcd-voltage = <6000000>;
	};
};
