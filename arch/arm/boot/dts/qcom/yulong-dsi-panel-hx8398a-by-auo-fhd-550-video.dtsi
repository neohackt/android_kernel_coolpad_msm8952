/* Copyright (c) 2014, The Linux Foundation. All rights reserved.
 *
 * This program is free software; you can redistribute it and/or modify
 * it under the terms of the GNU General Public License version 2 and
 * only version 2 as published by the Free Software Foundation.
 *
 * This program is distributed in the hope that it will be useful,
 * but WITHOUT ANY WARRANTY; without even the implied warranty of
 * MERCHANTABILITY or FITNESS FOR A PARTICULAR PURPOSE.  See the
 * GNU General Public License for more details.
 */

/*---------------------------------------------------------------------------
 * This file is autogenerated file using gcdb parser. Please do not edit it.
 * Update input XML file to add a new entry or update variable in this file
 * VERSION = "1.0"
 *---------------------------------------------------------------------------*/

&mdss_mdp {
  dsi_hx8398a_by_auo_fhd_vid: qcom,mdss_dsi_hx8398a_by_auo_fhd_video {
		qcom,cont-splash-enabled;
		qcom,mdss-dsi-panel-name = "LCD_TYPE_HX8398A_BY_AUO_FHD_550";
		qcom,mdss-dsi-panel-type = "dsi_video_mode";
		qcom,mdss-dsi-panel-framerate = <60>;
		qcom,mdss-dsi-virtual-channel-id = <0>;
		qcom,mdss-dsi-stream = <0>;
		qcom,mdss-dsi-panel-width = <1080>;
		qcom,mdss-dsi-panel-height = <1920>;
		qcom,mdss-dsi-h-front-porch = <130>;
		qcom,mdss-dsi-h-back-porch = <130>;
		qcom,mdss-dsi-h-pulse-width = <52>;
		qcom,mdss-dsi-h-sync-skew = <0>;
		qcom,mdss-dsi-v-back-porch = <22>;
		qcom,mdss-dsi-v-front-porch = <32>;
		qcom,mdss-dsi-v-pulse-width = <4>;
		qcom,mdss-dsi-h-left-border = <0>;
		qcom,mdss-dsi-h-right-border = <0>;
		qcom,mdss-dsi-v-top-border = <0>;
		qcom,mdss-dsi-v-bottom-border = <0>;
		qcom,mdss-dsi-bpp = <24>;
		qcom,mdss-dsi-underflow-color = <0xff>;
		qcom,mdss-dsi-border-color = <0>;
		qcom,mdss-dsi-pixel-packing = <0>;
		qcom,mdss-dsi-on-command = [
			39 01 00 00 00 00 04 B9 FF 83 98
			39 01 00 00 00 00 0C B1 28 0A 8A 01 02 33 53 33 4C 41 0D
			39 01 00 00 00 00 0B B2 40 00 AE 1C 0B 45 11 00 00 00
			39 01 00 00 00 00 1A B4 00 FF 30 A0 30 A0 30 A0 00 2F A2 11 07 3A 30 A0 30 A0 30 A0 00 2F A2 3A 00
			39 01 00 00 00 00 02 BD 02
			39 01 00 00 00 00 04 D3 00 04 50
			39 01 00 00 00 00 02 BD 00
			39 01 00 00 00 00 30 D3 20 00 10 08 10 08 00 00 1F 2F 54 10 03 00 03 54 17 A1 07 A1 00 00 00 00 00 77 07 0B 0B 7F 03 03 7F 18 40 00 03 29 00 E2 00 00 00 04 29 30 A0
			39 01 00 00 00 00 29 D5 18 18 18 18 21 20 18 18 18 18 17 16 07 06 15 14 05 04 13 12 03 02 11 10 01 00 18 18 39 38 25 24 18 18 18 18 18 18 18 18
			39 01 00 00 00 00 29 D6 18 18 18 18 24 25 18 18 18 18 00 01 10 11 02 03 12 13 04 05 14 15 06 07 16 17 38 39 18 18 20 21 18 18 18 18 18 18 18 18
			39 01 00 00 00 00 02 CC 02
			39 01 00 00 00 00 15 D8 08 2A AA 82 00 08 2A AA 82 00 00 00 00 00 00 00 00 00 00 00
			39 01 00 00 00 00 02 BD 01
			39 01 00 00 00 00 15 D8 08 2A AA 82 00 08 2A AA 82 00 00 00 00 00 00 00 00 00 00 00
			39 01 00 00 00 00 02 BD 02
			39 01 00 00 00 00 0B D8 F8 2A AA 82 00 F8 2A AA 82 00
			39 01 00 00 00 00 02 BD 00
			39 01 00 00 00 00 3B E0 27 29 2C 30 32 34 36 33 68 72 80 7E 83 96 9A 9D AB AC AD B9 D1 62 61 60 61 60 6F 6F 70 25 29 2C 30 32 34 36 33 68 72 80 7E 83 96 9A 9D AB AC AD B9 D1 62 61 60 61 60 6F 6F 70
			05 01 00 00 78 00 02 11 00
			39 01 00 00 00 00 02 BC 07
			05 01 00 00 14 00 02 29 00
			];
		qcom,mdss-dsi-off-command = [
			05 01 00 00 32 00 02 28 00
			05 01 00 00 78 00 02 10 00
			];
		qcom,panel-ce-cmds = [
			29 01 00 00 00 00 02 55 93
			];
		qcom,panel-ce-off-cmds = [
			29 01 00 00 00 00 02 55 03
			];
		qcom,panel-ce-level1-cmds = [
			29 01 00 00 00 00 02 55 83
			];
		qcom,panel-ce-level2-cmds = [
			29 01 00 00 00 00 02 55 93
			];
		qcom,panel-ce-level3-cmds = [
			29 01 00 00 00 00 02 55 B3
			];
		qcom,panel-cabc-ui-cmds = [
			29 01 00 00 00 00 02 55 91
			];
		qcom,panel-cabc-still-cmds = [
			29 01 00 00 00 00 02 55 92
			];
		qcom,panel-cabc-moving-cmds = [
			29 01 00 00 00 00 02 55 93
			];
		qcom,panel-cabc-off-cmds = [
			29 01 00 00 00 00 02 55 00
			];
		qcom,panel-backlight-response-curve = [
			00 01 01 01 02 02 02 03
			03 03 03 04 04 05 05 06
			06 07 07 08 08 09 09 0A
			0A 0B 0B 0C 0C 0D 0D 0E
			0E 0F 0F 10 10 11 11 12
			12 12 12 13 13 13 13 14
			14 14 14 15 15 15 15 16
			16 16 16 17 17 17 17 18
			18 18 18 19 19 19 19 1A
			1A 1A 1A 1B 1B 1B 1B 1C
			1C 1C 1C 1D 1D 1D 1D 1E
			1E 1E 1E 1F 1F 1F 1F 20
			20 20 20 21 21 21 21 22
			24 26 28 2A 2C 2E 30 32
			34 36 38 3A 3C 3E 40 42
			44 46 48 4A 4B 4C 4D 4E
			4F 50 51 51 52 53 54 54
			55 56 57 57 58 59 5A 5B
			5C 5E 5F 61 62 64 65 67
			68 6A 6B 6C 6E 6F 71 72
			74 75 77 78 7A 7B 7D 7E
			7F 81 82 84 85 87 89 8B
			8C 8D 8E 90 91 92 94 95
			97 98 9A 9B 9D 9E A0 A1
			A3 A4 A5 A7 A8 AA AB AD
			AE AF B1 B3 B4 B5 B7 B8
			BA BB BD BE BF C1 C4 C5
			C7 C8 C9 CA CB CD CE D0
			D1 D3 D4 D6 D7 D9 DA DB
			DD DE E0 E1 E3 E4 E6 E7
			E9 EA EC ED EE F0 F1 F3
			F4 F6 F7 F9 FA FC FD FF
		];
		qcom,mdss-dsi-on-command-state = "dsi_lp_mode";
		qcom,mdss-dsi-off-command-state = "dsi_lp_mode";
    /**************************************************
		qcom,esd-check-enabled;							//esd
		qcom,panel-alive-reg-content = [
				0A 01 9C
				];
		qcom,mdss-dsi-panel-status-command = [06 01 00 01 05 00 02 0A 08];
		qcom,mdss-dsi-panel-status-command-state = "dsi_lp_mode";
		qcom,mdss-dsi-panel-status-check-mode = "reg_read";		//esd
		qcom,mdss-dsi-panel-hx8394f;
    ***************************************************/
		qcom,mdss-dsi-h-sync-pulse = <1>;
		qcom,mdss-dsi-traffic-mode = "burst_mode";
		qcom,mdss-dsi-bllp-eof-power-mode;
		qcom,mdss-dsi-bllp-power-mode;
		qcom,mdss-dsi-lane-0-state;
		qcom,mdss-dsi-lane-1-state;
		qcom,mdss-dsi-lane-2-state;
		qcom,mdss-dsi-lane-3-state;
		qcom,mdss-dsi-panel-timings = [04 3E 2A 01 72 76 2E 42 33 03 04 00];
		qcom,mdss-dsi-t-clk-post = <0x02>;
		qcom,mdss-dsi-t-clk-pre = <0x2F>;
		qcom,mdss-dsi-bl-min-level = <1>;
		qcom,mdss-dsi-bl-max-level = <4095>;
		qcom,mdss-dsi-dma-trigger = "trigger_sw";
		qcom,mdss-dsi-mdp-trigger = "none";
		qcom,mdss-dsi-bl-pmic-control-type = "bl_ctrl_wled";
              qcom,mdss-dsi-reset-sequence = <1 20>, <0 10>, <1 20>;
		qcom,mdss-pan-physical-width-dimension = <68>;
		qcom,mdss-pan-physical-height-dimension = <121>;
		qcom,mdss-dsi-lp11-init;
		qcom,mdss-dsi-init-delay-us = <200>;
		qcom,suspend-ulps-enabled;
		qcom,mdss-dsi-avdd-avee-enabled;
		qcom,mdss-dsi-avdd-init-lcd-voltage = <5500000>;
		qcom,mdss-dsi-avee-init-lcd-voltage = <5500000>;
	};
};
