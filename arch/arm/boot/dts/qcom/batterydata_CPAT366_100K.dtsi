
qcom,CPAT366_100K {
	/* #2097764_Yulong_CPAT_3000mAh_averaged_MasterSlave_Aug3rd2015 ATL */
	qcom,max-voltage-uv = <4350000>;
	qcom,nom-batt-capacity-mah = <3000>;
	qcom,batt-id-kohm = <100>;
	qcom,battery-beta = <3435>;
	qcom,battery-type = "CPAT366_100K";
	qcom,chg-rslow-comp-c1 = <2075319>;
	qcom,chg-rslow-comp-c2 = <1606849>;
	qcom,chg-rs-to-rslow = <754097>;
	qcom,chg-rslow-comp-thr = <0x99>;
	qcom,checksum = <0x2757>;
	qcom,gui-version = "PMI8950GUI - 2.0.0.11";
	qcom,fg-profile-data = [
		 DD 83 77 7C 
		 8C 80 22 76 
		 52 83 4E 5A 
		 D1 7B EB 86 
		 1D 82 34 9A 
		 4E BD 43 CA 
		 5C 0E 07 88 
		 CA 7D 6A 81 
		 9F 77 45 83 
		 DA 72 62 7C 
		 70 63 5C 82 
		 00 99 09 BC 
		 65 C8 5E 0D 
		 30 0C 7A 60 
		 CE 6E 77 FE 
		 BF 44 C0 36 
		 56 3A 00 00 
		 20 4C 86 3A 
		 3F 39 00 00 
		 00 00 00 00 
		 00 00 00 00 
		 B2 6A 4A 69 
		 8B 53 4D 81 
		 61 75 BF 63 
		 68 70 8C 83 
		 04 75 42 63 
		 C1 5A 61 A9 
		 17 64 60 54 
		 5D A0 71 0C 
		 28 00 FF 36 
		 F0 11 30 03 
		 00 00 00 0C 
	];
};
