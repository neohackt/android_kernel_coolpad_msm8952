/* Copyright (c) 2014, The Linux Foundation. All rights reserved.
 *
 * This program is free software; you can redistribute it and/or modify
 * it under the terms of the GNU General Public License version 2 and
 * only version 2 as published by the Free Software Foundation.
 *
 * This program is distributed in the hope that it will be useful,
 * but WITHOUT ANY WARRANTY; without even the implied warranty of
 * MERCHANTABILITY or FITNESS FOR A PARTICULAR PURPOSE.  See the
 * GNU General Public License for more details.
 */

/*---------------------------------------------------------------------------
 * This file is autogenerated file using gcdb parser. Please do not edit it.
 * Update input XML file to add a new entry or update variable in this file
 * VERSION = "1.0"
 *---------------------------------------------------------------------------*/

&mdss_mdp {
	dsi_ili9885_ys_cmi_fhd_vid: qcom,mdss_dsi_ili9885_ys_cmi_fhd_video {
		qcom,cont-splash-enabled;
		qcom,mdss-dsi-panel-name = "LCD_TYPE_ILI9885_YS_CMI_FHD_550";
		qcom,mdss-dsi-panel-type = "dsi_video_mode";
		qcom,mdss-dsi-panel-framerate = <60>;
		qcom,mdss-dsi-virtual-channel-id = <0>;
		qcom,mdss-dsi-stream = <0>;
		qcom,mdss-dsi-panel-width = <1080>;
		qcom,mdss-dsi-panel-height = <1920>;
		qcom,mdss-dsi-h-front-porch = <84>;
		qcom,mdss-dsi-h-back-porch = <82>;
		qcom,mdss-dsi-h-pulse-width = <16>;
		qcom,mdss-dsi-h-sync-skew = <0>;
		qcom,mdss-dsi-v-back-porch = <24>;
		qcom,mdss-dsi-v-front-porch = <32>;
		qcom,mdss-dsi-v-pulse-width = <8>;
		qcom,mdss-dsi-h-left-border = <0>;
		qcom,mdss-dsi-h-right-border = <0>;
		qcom,mdss-dsi-v-top-border = <0>;
		qcom,mdss-dsi-v-bottom-border = <0>;
		qcom,mdss-dsi-bpp = <24>;
		qcom,mdss-dsi-underflow-color = <0xff>;
		qcom,mdss-dsi-border-color = <0>;
		qcom,mdss-dsi-pixel-packing = <0>;
		qcom,mdss-dsi-on-command = [
			39 01 00 00 00 00 04 B0 98 85 0A
			39 01 00 00 00 00 07 D0 22 05 23 6C 63 00
			39 01 00 00 00 00 03 D1 0A 0A
			39 01 00 00 00 00 05 D2 03 03 2A 22
			39 01 00 00 00 00 0A D3 66 66 05 03 7C 7C 88 2B 22
			39 01 00 00 00 00 0F D5 00 00 00 00 01 53 01 53 00 FF 00 00 00 00
			39 01 00 00 00 00 08 EC 76 1E 32 00 46 00 02
			39 01 00 00 00 00 09 EF 3C 05 52 13 e1 33 5b 09
			39 01 00 00 00 00 0D D6 00 00 08 17 23 65 77 44 87 00 00 09
			39 01 00 00 00 00 4A E5 F6 F6 F6 A8 F6 18 0A 5C 4E 38 2A F6 F6 5B 64 8C 36 36 36 C8 F6 F6 F6 A1 F6 11 03 55 47 31 23 F6 F6 5B 64 85 36 36 36 C1 0e 40 70 00 00 00 40 04 00 01 01 24 00 00 00 00 00 00 00 00 00 00 00 00 00 13 13 13 13 13 13 00 07
			39 01 00 00 00 00 43 EA 51 13 00 00 00 00 00 40 00 00 00 00 00 00 0d 00 00 00 00 00 00 00 00 0f 03 00 00 00 3c 70 01 21 00 40 80 c0 00 00 01 23 45 67 89 ab cd ef 33 33 33 22 33 00 00 00 00 11 11 33 33 DD DD 22 CC CC CC 33
			39 01 00 00 00 00 18 ED 00 01 00 00 00 00 00 00 00 00 00 00 00 00 00 00 00 00 00 00 00 00 40
			39 01 00 00 00 00 14 EE 22 10 02 02 0F 40 00 07 00 04 00 00 C0 B9 77 00 55 05 1F
			39 01 00 00 00 00 21 EB A3 CF 66 18 54 55 55 55 55 50 A9 6A 55 AA 56 25 0D 0F 00 00 00 00 00 55 55 55 55 32 3E 55 43 55
			39 01 00 00 00 00 7B C7 00 CD 00 D7 00 E9 00 FA 01 09 01 17 01 23 01 2F 01 3A 01 5F 01 7D 01 AD 01 D1 02 0A 02 37 02 39 02 64 02 98 02 BB 02 EA 03 0A 03 35 03 42 03 50 03 61 03 74 03 8A 03 AB 03 D2 03 E6 00 CD 00 D7 00 E9 00 FA 01 09 01 17 01 23 01 2F 01 3A 01 5F 01 7D 01 AD 01 D1 02 0A 02 37 02 39 02 64 02 98 02 BB 02 EA 03 0A 03 35 03 42 03 50 03 61 03 74 03 8A 03 AB 03 D2 03 E6 01 01
			05 01 00 00 78 00 02 11 00
			39 01 00 00 00 00 02 F5 85
			39 01 00 00 00 00 02 BA 04
			39 01 00 00 00 00 02 F5 00
			05 01 00 00 0A 00 02 29 00
			];
		qcom,mdss-dsi-off-command = [
			05 01 00 00 32 00 02 28 00
			05 01 00 00 78 00 02 10 00
			];
		qcom,panel-ce-cmds = [
			29 01 00 00 00 00 02 55 93
			];
		qcom,panel-ce-off-cmds = [
			29 01 00 00 00 00 02 55 03
			];
		qcom,panel-ce-level1-cmds = [
			29 01 00 00 00 00 02 55 83
			];
		qcom,panel-ce-level2-cmds = [
			29 01 00 00 00 00 02 55 93
			];
		qcom,panel-ce-level3-cmds = [
			29 01 00 00 00 00 02 55 B3
			];
		qcom,panel-cabc-ui-cmds = [
			29 01 00 00 00 00 02 55 91
			];
		qcom,panel-cabc-still-cmds = [
			29 01 00 00 00 00 02 55 92
			];
		qcom,panel-cabc-moving-cmds = [
			29 01 00 00 00 00 02 55 93
			];
		qcom,panel-cabc-off-cmds = [
			29 01 00 00 00 00 02 55 00
			];
		qcom,panel-backlight-response-curve = [
			00 01 01 01 02 02 02 03
			03 03 03 04 04 05 05 06
			06 07 07 08 08 09 09 0A
			0A 0B 0B 0C 0C 0D 0D 0E
			0E 0F 0F 10 10 11 11 12
			12 12 12 13 13 13 13 14
			14 14 14 15 15 15 15 16
			16 16 16 17 17 17 17 18
			18 18 18 19 19 19 19 1A
			1A 1A 1A 1B 1B 1B 1B 1C
			1C 1C 1C 1D 1D 1D 1D 1E
			1E 1E 1E 1F 1F 1F 1F 20
			20 20 20 21 21 21 21 22
			24 26 28 2A 2C 2E 30 32
			34 36 38 3A 3C 3E 40 42
			44 46 48 4A 4B 4C 4D 4E
			4F 50 51 51 52 53 54 54
			55 56 57 57 58 59 5A 5B
			5C 5E 5F 61 62 64 65 67
			68 6A 6B 6C 6E 6F 71 72
			74 75 77 78 7A 7B 7D 7E
			7F 81 82 84 85 87 89 8B
			8C 8D 8E 90 91 92 94 95
			97 98 9A 9B 9D 9E A0 A1
			A3 A4 A5 A7 A8 AA AB AD
			AE AF B1 B3 B4 B5 B7 B8
			BA BB BD BE BF C1 C4 C5
			C7 C8 C9 CA CB CD CE D0
			D1 D3 D4 D6 D7 D9 DA DB
			DD DE E0 E1 E3 E4 E6 E7
			E9 EA EC ED EE F0 F1 F3
			F4 F6 F7 F9 FA FC FD FF
		];
		qcom,mdss-dsi-on-command-state = "dsi_lp_mode";
		qcom,mdss-dsi-off-command-state = "dsi_lp_mode";
    /**************************************************
		qcom,esd-check-enabled;							//esd
		qcom,panel-alive-reg-content = [
				0A 01 9C
				];
		qcom,mdss-dsi-panel-status-command = [06 01 00 01 05 00 02 0A 08];
		qcom,mdss-dsi-panel-status-command-state = "dsi_lp_mode";
		qcom,mdss-dsi-panel-status-check-mode = "reg_read";		//esd
    ***************************************************/
		qcom,mdss-dsi-h-sync-pulse = <1>;
		qcom,mdss-dsi-traffic-mode = "burst_mode";
		qcom,mdss-dsi-bllp-eof-power-mode;
		qcom,mdss-dsi-bllp-power-mode;
		qcom,mdss-dsi-lane-0-state;
		qcom,mdss-dsi-lane-1-state;
		qcom,mdss-dsi-lane-2-state;
		qcom,mdss-dsi-lane-3-state;
		qcom,mdss-dsi-panel-timings = [EE 38 26 00 6A 6C 2C 3C 2C 03 04 00];
		qcom,mdss-dsi-t-clk-post = <0x02>;
		qcom,mdss-dsi-t-clk-pre = <0x2C>;
		qcom,mdss-dsi-bl-min-level = <1>;
		qcom,mdss-dsi-bl-max-level = <4095>;
		qcom,mdss-dsi-dma-trigger = "trigger_sw";
		qcom,mdss-dsi-mdp-trigger = "none";
		qcom,mdss-dsi-bl-pmic-control-type = "bl_ctrl_wled";
		qcom,mdss-dsi-reset-sequence = <1 20>, <0 10>, <1 20>;
		qcom,mdss-pan-physical-width-dimension = <68>;
		qcom,mdss-pan-physical-height-dimension = <121>;
		qcom,mdss-dsi-lp11-init;
		qcom,mdss-dsi-init-delay-us = <200>;
		qcom,suspend-ulps-enabled;
		qcom,mdss-dsi-avdd-avee-enabled;
		qcom,mdss-dsi-avdd-init-lcd-voltage = <5500000>;
		qcom,mdss-dsi-avee-init-lcd-voltage = <5500000>;
	};
};
