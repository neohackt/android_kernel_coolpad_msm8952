/* Copyright (c) 2014, The Linux Foundation. All rights reserved.
 *
 * This program is free software; you can redistribute it and/or modify
 * it under the terms of the GNU General Public License version 2 and
 * only version 2 as published by the Free Software Foundation.
 *
 * This program is distributed in the hope that it will be useful,
 * but WITHOUT ANY WARRANTY; without even the implied warranty of
 * MERCHANTABILITY or FITNESS FOR A PARTICULAR PURPOSE.  See the
 * GNU General Public License for more details.
 */

/*---------------------------------------------------------------------------
 * This file is autogenerated file using gcdb parser. Please do not edit it.
 * Update input XML file to add a new entry or update variable in this file
 * VERSION = "1.0"
 *---------------------------------------------------------------------------*/

&mdss_mdp {
	dsi_ili9885_lide_auo_fhd_vid: qcom,mdss_dsi_ili9885_lide_auo_fhd_video {
		qcom,cont-splash-enabled;
		qcom,mdss-dsi-panel-name = "LCD_TYPE_ILI9885_LIDE_AUO_FHD_550";
		qcom,mdss-dsi-panel-type = "dsi_video_mode";
		qcom,mdss-dsi-panel-framerate = <60>;
		qcom,mdss-dsi-virtual-channel-id = <0>;
		qcom,mdss-dsi-stream = <0>;
		qcom,mdss-dsi-panel-width = <1080>;
		qcom,mdss-dsi-panel-height = <1920>;
		qcom,mdss-dsi-h-front-porch = <81>;
		qcom,mdss-dsi-h-back-porch = <81>;
		qcom,mdss-dsi-h-pulse-width = <16>;
		qcom,mdss-dsi-h-sync-skew = <0>;
		qcom,mdss-dsi-v-back-porch = <24>;
		qcom,mdss-dsi-v-front-porch = <32>;
		qcom,mdss-dsi-v-pulse-width = <8>;
		qcom,mdss-dsi-h-left-border = <0>;
		qcom,mdss-dsi-h-right-border = <0>;
		qcom,mdss-dsi-v-top-border = <0>;
		qcom,mdss-dsi-v-bottom-border = <0>;
		qcom,mdss-dsi-bpp = <24>;
		qcom,mdss-dsi-underflow-color = <0xff>;
		qcom,mdss-dsi-border-color = <0>;
		qcom,mdss-dsi-pixel-packing = <0>;
		qcom,mdss-dsi-on-command = [
			39 01 00 00 00 00 04 B0 98 85 0A
			39 01 00 00 00 00 08 C4 70 19 23 00 0F 0F 00
			39 01 00 00 00 00 07 D0 33 05 34 6B 67 C0
			39 01 00 00 00 00 05 D2 13 13 EA 22
			39 01 00 00 00 00 0A D3 33 33 05 03 59 59 22 26 22
			39 01 00 00 00 00 0B D5 00 00 00 00 01 83 01 83 01 83
			39 01 00 00 00 00 08 EC 76 1E 32 00 46 00 02
			39 01 00 00 00 00 09 EF 3C 05 52 13 E1 33 5b 09
			39 01 00 00 00 00 0D D6 00 00 08 17 23 65 77 44 87 00 00 09
			39 01 00 00 00 00 24 EB 9b C7 73 00 58 55 55 55 55 54 00 00 00 00 00 25 4D 0F FF FF FF FF FF 55 55 55 55 32 77 55 43 55 5E FF 55
			39 01 00 00 00 00 4A E5 36 36 A1 F6 F6 47 07 55 15 63 23 71 31 6E 36 85 36 36 36 36 36 36 A8 F6 F6 4E 0E 5C 1C 6A 2A 78 38 76 35 8C 36 36 36 36 18 70 61 00 4E BB 70 80 00 4E BB F7 00 4E BB 00 00 00 00 00 00 00 00 00 00 00 00 00 00 00 00 00 07
			39 01 00 00 00 00 43 EA 51 00 00 00 00 00 00 40 00 00 00 00 00 00 0F 00 00 00 96 95 10 11 00 0A 00 0F 00 00 00 70 01 10 00 40 80 C0 00 00 01 23 45 67 89 AB CD EF CC CC 22 33 33 00 11 00 11 00 11 00 11 CC DD 22 CC CC CC CC
			39 01 00 00 00 00 18 ED 00 01 00 00 00 00 00 00 00 00 00 00 00 00 00 00 00 00 00 00 00 00 40
			39 01 00 00 00 00 14 EE 22 10 02 02 0F 40 00 07 00 04 00 00 C0 B9 77 00 55 05 1F
			39 01 00 00 00 00 7B C7 00 8A 00 77 00 A5 00 C2 00 DA 00 EE 00 FF 01 0E 01 1B 01 47 01 6B 01 A1 01 CC 02 0F 02 46 02 47 02 7A 02 B2 02 D6 03 06 03 25 03 4C 03 58 03 65 03 74 03 83 03 95 03 AB 03 C4 03 D0 00 10 00 77 00 A5 00 C2 00 DA 00 EE 00 FF 01 0E 01 1B 01 47 01 6B 01 A1 01 CC 02 0F 02 46 02 47 02 7A 02 B2 02 D6 03 06 03 25 03 4C 03 58 03 65 03 74 03 83 03 95 03 AB 03 C4 03 D0 01 01
			05 01 00 00 78 00 02 11 00
			39 01 00 00 01 00 02 F5 85
			39 01 00 00 01 00 02 BA 04
			39 01 00 00 00 00 02 F5 00
			//39 01 00 00 00 00 02 55 80  //Color enhancement B:80 M:90 H:B0
			05 01 00 00 0A 00 02 29 00
			];
		qcom,mdss-dsi-off-command = [
			05 01 00 00 32 00 02 28 00
			05 01 00 00 78 00 02 10 00
			];
		qcom,panel-ce-cmds = [
			29 01 00 00 00 00 02 55 93
			];
		qcom,panel-ce-off-cmds = [
			29 01 00 00 00 00 02 55 03
			];
		qcom,panel-ce-level1-cmds = [
			29 01 00 00 00 00 02 55 83
			];
		qcom,panel-ce-level2-cmds = [
			29 01 00 00 00 00 02 55 93
			];
		qcom,panel-ce-level3-cmds = [
			29 01 00 00 00 00 02 55 B3
			];
		qcom,panel-cabc-ui-cmds = [
			29 01 00 00 00 00 02 55 91
			];
		qcom,panel-cabc-still-cmds = [
			29 01 00 00 00 00 02 55 92
			];
		qcom,panel-cabc-moving-cmds = [
			29 01 00 00 00 00 02 55 93
			];
		qcom,panel-cabc-off-cmds = [
			29 01 00 00 00 00 02 55 00
			];
		qcom,panel-backlight-response-curve = [
			00 01 01 01 01 01 01 02
			02 02 03 03 03 04 04 05
			05 06 06 07 07 08 08 09
			09 0A 0A 0B 0B 0C 0C 0D
			0D 0E 0E 0F 0F 10 10 11
			11 12 12 13 13 14 14 15
			15 16 16 17 17 18 18 19
			19 19 1A 1A 1B 1B 1C 1C
			1D 1D 1E 1E 1F 1F 20 20
			21 21 22 22 23 23 24 24
			25 25 26 26 27 27 28 28
			29 29 2A 2A 2B 2B 2C 2C
			2D 2D 2E 2E 2F 2F 30 31
			32 33 34 36 37 38 39 3B
			3C 3D 3E 40 41 42 43 45
			46 47 48 4A 4B 4C 4D 4F
			50 51 52 54 55 56 57 59
			5A 5B 5C 5E 5F 60 61 62
			64 65 66 67 69 6A 6B 6C
			6E 6F 70 71 73 74 75 76
			78 79 7A 7B 7D 7E 7F 80
			82 83 84 85 87 88 89 8A
			8C 8D 8E 8F 91 92 93 94
			96 97 98 99 9B 9C 9D 9E
			A0 A1 A2 A4 A5 A6 A7 A9
			AA AB AC AE AF B0 B1 B3
			B4 B5 B7 B8 B9 BA BC BD
			BE BF C1 C2 C3 C4 C6 C7
			C8 CA CB CC CD CF D0 D1
			D2 D4 D5 D6 D7 D9 DA DB
			DD DE DF E0 E2 E3 E4 E5
			E7 E8 E9 EA EC ED EE F0
		];
		qcom,mdss-dsi-on-command-state = "dsi_lp_mode";
		qcom,mdss-dsi-off-command-state = "dsi_lp_mode";
    /**************************************************
		qcom,esd-check-enabled;							//esd
		qcom,panel-alive-reg-content = [
				0A 01 9C
				];
		qcom,mdss-dsi-panel-status-command = [06 01 00 01 05 00 02 0A 08];
		qcom,mdss-dsi-panel-status-command-state = "dsi_lp_mode";
		qcom,mdss-dsi-panel-status-check-mode = "reg_read";		//esd
    ***************************************************/
		qcom,mdss-dsi-h-sync-pulse = <1>;
		qcom,mdss-dsi-traffic-mode = "burst_mode";
		qcom,mdss-dsi-bllp-eof-power-mode;
		qcom,mdss-dsi-bllp-power-mode;
		qcom,mdss-dsi-lane-0-state;
		qcom,mdss-dsi-lane-1-state;
		qcom,mdss-dsi-lane-2-state;
		qcom,mdss-dsi-lane-3-state;
		qcom,mdss-dsi-panel-timings = [E6 38 26 00 68 60 2A 3C 2C 03 04 00];
		qcom,mdss-dsi-t-clk-post = <0x02>;
		qcom,mdss-dsi-t-clk-pre = <0x2B>;
		qcom,mdss-dsi-bl-min-level = <1>;
		qcom,mdss-dsi-bl-max-level = <4095>;
		qcom,mdss-dsi-dma-trigger = "trigger_sw";
		qcom,mdss-dsi-mdp-trigger = "none";
		qcom,mdss-dsi-bl-pmic-control-type = "bl_ctrl_wled";
		qcom,mdss-dsi-reset-sequence = <1 20>, <0 10>, <1 20>;
		qcom,mdss-pan-physical-width-dimension = <68>;
		qcom,mdss-pan-physical-height-dimension = <121>;
		qcom,mdss-dsi-lp11-init;
		qcom,mdss-dsi-init-delay-us = <200>;
		qcom,suspend-ulps-enabled;
		qcom,mdss-dsi-avdd-avee-enabled;
		qcom,mdss-dsi-avdd-init-lcd-voltage = <5500000>;
		qcom,mdss-dsi-avee-init-lcd-voltage = <5500000>;
		qcom,mdss-dsi-resetdown-after-avdd-avee-enabled;
	};
};
