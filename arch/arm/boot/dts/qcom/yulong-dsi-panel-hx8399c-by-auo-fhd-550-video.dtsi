/* Copyright (c) 2014, The Linux Foundation. All rights reserved.
 *
 * This program is free software; you can redistribute it and/or modify
 * it under the terms of the GNU General Public License version 2 and
 * only version 2 as published by the Free Software Foundation.
 *
 * This program is distributed in the hope that it will be useful,
 * but WITHOUT ANY WARRANTY; without even the implied warranty of
 * MERCHANTABILITY or FITNESS FOR A PARTICULAR PURPOSE.  See the
 * GNU General Public License for more details.
 */

/*---------------------------------------------------------------------------
 * This file is autogenerated file using gcdb parser. Please do not edit it.
 * Update input XML file to add a new entry or update variable in this file
 * VERSION = "1.0"
 *---------------------------------------------------------------------------*/

&mdss_mdp {
    dsi_hx8399c_by_auo_fhd_vid: qcom,mdss_dsi_hx8399c_by_auo_fhd_video {
	qcom,cont-splash-enabled;
	qcom,mdss-dsi-panel-name = "LCD_TYPE_HX8399C_BY_AUO_FHD_550";
	qcom,mdss-dsi-panel-type = "dsi_video_mode";
	qcom,mdss-dsi-panel-framerate = <60>;
	qcom,mdss-dsi-virtual-channel-id = <0>;
	qcom,mdss-dsi-stream = <0>;
	qcom,mdss-dsi-panel-width = <1080>;
	qcom,mdss-dsi-panel-height = <1920>;
	qcom,mdss-dsi-h-front-porch = <100>;
	qcom,mdss-dsi-h-back-porch = <80>;
	qcom,mdss-dsi-h-pulse-width = <20>;
	qcom,mdss-dsi-h-sync-skew = <0>;
	qcom,mdss-dsi-v-back-porch = <16>;
	qcom,mdss-dsi-v-front-porch = <16>;
	qcom,mdss-dsi-v-pulse-width = <5>;
	qcom,mdss-dsi-h-left-border = <0>;
	qcom,mdss-dsi-h-right-border = <0>;
	qcom,mdss-dsi-v-top-border = <0>;
	qcom,mdss-dsi-v-bottom-border = <0>;
	qcom,mdss-dsi-bpp = <24>;
	qcom,mdss-dsi-underflow-color = <0xff>;
	qcom,mdss-dsi-border-color = <0>;
	qcom,mdss-dsi-pixel-packing = <0>;
	qcom,mdss-dsi-on-command = [
		39 01 00 00 00 00 04 B9 FF 83 99
		39 01 00 00 00 00 10 B1 02 04 6D 8D 01 32 33 11 11 5A 5F 56 73 02 02
		39 01 00 00 00 00 0C B2 00 80 80 AE 05 07 5A 11 10 10 00
		39 01 00 00 00 00 2D B4 00 FF 10 18 04 9A 00 00 06 00 02 04 00 24 02 04 0A 21 03 00 00 02 9F 88 10 18 04 9A 00 00 08 00 02 04 00 24 02 04 0A 00 00 02 9F 12
		39 01 00 00 00 00 22 D3 00 00 00 00 00 00 30 00 00 00 05 00 05 00 07 88 07 88 00 00 00 00 00 15 00 00 00 01 00 00 00 05 40
		39 01 00 00 00 00 21 D5 20 20 19 19 18 18 01 01 00 00 25 25 18 18 18 18 24 24 18 18 18 18 18 18 18 18 2F 2F 30 30 31 31
		39 01 00 00 00 00 21 D6 24 24 18 18 19 19 00 00 01 01 25 25 18 18 18 18 20 20 18 18 18 18 18 18 18 18 2F 2F 30 30 31 31
		39 01 00 00 00 00 11 D8 AA 8A AA AA AA 8A AA AA AA 8A AA AA AA 8A AA AA
		39 01 00 00 00 00 02 BD 01
		39 01 00 00 00 00 11 D8 FF FC C0 3F FF FC C0 3F FF FC C0 3F FF FC C0 3F
		39 01 00 00 00 00 02 BD 02
		39 01 00 00 00 00 09 D8 FF FC C0 3F FF FC C0 3F
		39 01 00 00 00 00 02 BD 00
		39 01 00 00 00 00 02 CC 08
		39 01 00 00 00 00 37 E0 02 2C 3A 35 6E 76 81 7C 81 89 91 94 99 9C A4 A6 A9 AF B1 B8 A9 B6 B9 5F 5A 62 7C 02 2C 3A 35 6E 76 81 7C 81 89 91 94 99 9C A3 A5 A7 AF B1 B6 AA B6 B7 5E 59 62 7C
		39 01 00 00 00 00 02 D0 39
		05 01 00 00 78 00 02 11 00
		05 01 00 00 32 00 02 29 00
		];
        qcom,mdss-dsi-off-command = [
		05 01 00 00 32 00 02 28 00
		05 01 00 00 78 00 02 10 00
		];
        qcom,panel-ce-cmds = [
		29 01 00 00 00 00 02 55 93
		];
        qcom,panel-ce-off-cmds = [
		29 01 00 00 00 00 02 55 03
		];
        qcom,panel-ce-level1-cmds = [
		29 01 00 00 00 00 02 55 83
		];
        qcom,panel-ce-level2-cmds = [
		29 01 00 00 00 00 02 55 93
		];
        qcom,panel-ce-level3-cmds = [
		29 01 00 00 00 00 02 55 B3
		];
        qcom,panel-cabc-ui-cmds = [
		29 01 00 00 00 00 02 55 91
		];
        qcom,panel-cabc-still-cmds = [
		29 01 00 00 00 00 02 55 92
		];
        qcom,panel-cabc-moving-cmds = [
		29 01 00 00 00 00 02 55 93
		];
        qcom,panel-cabc-off-cmds = [
		29 01 00 00 00 00 02 55 00
		];
        qcom,panel-backlight-response-curve = [
		00 01 01 01 02 02 02 03
		03 03 03 04 04 05 05 06
		06 07 07 08 08 09 09 0A
		0A 0B 0B 0C 0C 0D 0D 0E
		0E 0F 0F 10 10 11 11 12
		12 12 12 13 13 13 13 14
		14 14 14 15 15 15 15 16
		16 16 16 17 17 17 17 18
		18 18 18 19 19 19 19 1A
		1A 1A 1A 1B 1B 1B 1B 1C
		1C 1C 1C 1D 1D 1D 1D 1E
		1E 1E 1E 1F 1F 1F 1F 20
		20 20 20 21 21 21 21 22
		24 26 28 2A 2C 2E 30 32
		34 36 38 3A 3C 3E 40 42
		44 46 48 4A 4B 4C 4D 4E
		4F 50 51 51 52 53 54 54
		55 56 57 57 58 59 5A 5B
		5C 5E 5F 61 62 64 65 67
		68 6A 6B 6C 6E 6F 71 72
		74 75 77 78 7A 7B 7D 7E
		7F 81 82 84 85 87 89 8B
		8C 8D 8E 90 91 92 94 95
		97 98 9A 9B 9D 9E A0 A1
		A3 A4 A5 A7 A8 AA AB AD
		AE AF B1 B3 B4 B5 B7 B8
		BA BB BD BE BF C1 C4 C5
		C7 C8 C9 CA CB CD CE D0
		D1 D3 D4 D6 D7 D9 DA DB
		DD DE E0 E1 E3 E4 E6 E7
		E9 EA EC ED EE F0 F1 F3
		F4 F6 F7 F9 FA FC FD FF
        ];
        qcom,mdss-dsi-on-command-state = "dsi_lp_mode";
        qcom,mdss-dsi-off-command-state = "dsi_lp_mode";
    /**************************************************
	qcom,esd-check-enabled;                         //esd
	qcom,panel-alive-reg-content = [
	        0A 01 9D
	        ];
	qcom,mdss-dsi-panel-status-command = [06 01 00 01 05 00 02 0A 08];
	qcom,mdss-dsi-panel-status-command-state = "dsi_lp_mode";
	qcom,mdss-dsi-panel-status-check-mode = "reg_read";     //esd
	qcom,mdss-dsi-panel-hx8394f;
    ***************************************************/
	qcom,mdss-dsi-h-sync-pulse = <1>;
	qcom,mdss-dsi-traffic-mode = "burst_mode";
	qcom,mdss-dsi-bllp-eof-power-mode;
	qcom,mdss-dsi-bllp-power-mode;
	qcom,mdss-dsi-lane-0-state;
	qcom,mdss-dsi-lane-1-state;
	qcom,mdss-dsi-lane-2-state;
	qcom,mdss-dsi-lane-3-state;
	qcom,mdss-dsi-panel-timings = [EE 38 26 00 6A 6C 2C 3C 2C 03 04 00];
	qcom,mdss-dsi-t-clk-post = <0x02>;
	qcom,mdss-dsi-t-clk-pre = <0x2C>;
	qcom,mdss-dsi-bl-min-level = <1>;
	qcom,mdss-dsi-bl-max-level = <4095>;
	qcom,mdss-dsi-dma-trigger = "trigger_sw";
	qcom,mdss-dsi-mdp-trigger = "none";
	qcom,mdss-dsi-bl-pmic-control-type = "bl_ctrl_wled";
	qcom,mdss-dsi-reset-sequence = <1 20>, <0 10>, <1 20>;
	qcom,mdss-pan-physical-width-dimension = <68>;
	qcom,mdss-pan-physical-height-dimension = <121>;
	qcom,mdss-dsi-lp11-init;
	qcom,mdss-dsi-init-delay-us = <200>;
	qcom,suspend-ulps-enabled;
	qcom,mdss-dsi-avdd-avee-enabled;
	qcom,mdss-dsi-avdd-init-lcd-voltage = <5500000>;
	qcom,mdss-dsi-avee-init-lcd-voltage = <5500000>;
    };
};
