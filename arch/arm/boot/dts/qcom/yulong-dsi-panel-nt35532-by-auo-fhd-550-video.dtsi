/* Copyright (c) 2014, The Linux Foundation. All rights reserved.
 *
 * This program is free software; you can redistribute it and/or modify
 * it under the terms of the GNU General Public License version 2 and
 * only version 2 as published by the Free Software Foundation.
 *
 * This program is distributed in the hope that it will be useful,
 * but WITHOUT ANY WARRANTY; without even the implied warranty of
 * MERCHANTABILITY or FITNESS FOR A PARTICULAR PURPOSE.  See the
 * GNU General Public License for more details.
 */

/*---------------------------------------------------------------------------
 * This file is autogenerated file using gcdb parser. Please do not edit it.
 * Update input XML file to add a new entry or update variable in this file
 * VERSION = "1.0"
 *---------------------------------------------------------------------------*/

&mdss_mdp {
	dsi_nt35532_by_auo_fhd_vid: qcom,mdss_dsi_nt35532_by_auo_fhd_video {
		qcom,cont-splash-enabled;
		qcom,mdss-dsi-panel-name = "LCD_TYPE_NT35532_BY_AUO_FHD_550";
		qcom,mdss-dsi-panel-type = "dsi_video_mode";
		qcom,mdss-dsi-panel-framerate = <60>;
		qcom,mdss-dsi-virtual-channel-id = <0>;
		qcom,mdss-dsi-stream = <0>;
		qcom,mdss-dsi-panel-width = <1080>;
		qcom,mdss-dsi-panel-height = <1920>;
		qcom,mdss-dsi-h-front-porch = <100>;
		qcom,mdss-dsi-h-back-porch = <80>;
		qcom,mdss-dsi-h-pulse-width = <20>;
		qcom,mdss-dsi-h-sync-skew = <0>;
		qcom,mdss-dsi-v-back-porch = <16>;
		qcom,mdss-dsi-v-front-porch = <16>;
		qcom,mdss-dsi-v-pulse-width = <5>;
		qcom,mdss-dsi-h-left-border = <0>;
		qcom,mdss-dsi-h-right-border = <0>;
		qcom,mdss-dsi-v-top-border = <0>;
		qcom,mdss-dsi-v-bottom-border = <0>;
		qcom,mdss-dsi-bpp = <24>;
		qcom,mdss-dsi-underflow-color = <0xff>;
		qcom,mdss-dsi-border-color = <0>;
		qcom,mdss-dsi-pixel-packing = <0>;
		qcom,mdss-dsi-on-command = [
			39 01 00 00 00 00 02 FF 01
			39 01 00 00 00 00 02 FB 01
			39 01 00 00 00 00 02 00 01
			39 01 00 00 00 00 02 01 55
			39 01 00 00 00 00 02 02 59
			39 01 00 00 00 00 02 04 0C
			39 01 00 00 00 00 02 05 2B
			39 01 00 00 00 00 02 06 64
			39 01 00 00 00 00 02 07 C6
			39 01 00 00 00 00 02 0D 89
			39 01 00 00 00 00 02 0E 89
			39 01 00 00 00 00 02 0F E0
			39 01 00 00 00 00 02 10 03
			39 01 00 00 00 00 02 11 5A
			39 01 00 00 00 00 02 12 5A
			39 01 00 00 00 00 02 15 60
			39 01 00 00 00 00 02 16 13
			39 01 00 00 00 00 02 17 13
			39 01 00 00 00 00 02 1C A3
			39 01 00 00 00 00 02 60 77
			39 01 00 00 00 00 02 FF 01
			39 01 00 00 00 00 02 FB 01
			39 01 00 00 00 00 02 75 00
			39 01 00 00 00 00 02 76 77
			39 01 00 00 00 00 02 77 00
			39 01 00 00 00 00 02 78 9C
			39 01 00 00 00 00 02 79 00
			39 01 00 00 00 00 02 7A 9E
			39 01 00 00 00 00 02 7B 00
			39 01 00 00 00 00 02 7C BD
			39 01 00 00 00 00 02 7D 00
			39 01 00 00 00 00 02 7E D6
			39 01 00 00 00 00 02 7F 00
			39 01 00 00 00 00 02 80 EB
			39 01 00 00 00 00 02 81 00
			39 01 00 00 00 00 02 82 FD
			39 01 00 00 00 00 02 83 01
			39 01 00 00 00 00 02 84 0D
			39 01 00 00 00 00 02 85 01
			39 01 00 00 00 00 02 86 1C
			39 01 00 00 00 00 02 87 01
			39 01 00 00 00 00 02 88 4C
			39 01 00 00 00 00 02 89 01
			39 01 00 00 00 00 02 8A 71
			39 01 00 00 00 00 02 8B 01
			39 01 00 00 00 00 02 8C AC
			39 01 00 00 00 00 02 8D 01
			39 01 00 00 00 00 02 8E D9
			39 01 00 00 00 00 02 8F 02
			39 01 00 00 00 00 02 90 1E
			39 01 00 00 00 00 02 91 02
			39 01 00 00 00 00 02 92 56
			39 01 00 00 00 00 02 93 02
			39 01 00 00 00 00 02 94 57
			39 01 00 00 00 00 02 95 02
			39 01 00 00 00 00 02 96 8B
			39 01 00 00 00 00 02 97 02
			39 01 00 00 00 00 02 98 C5
			39 01 00 00 00 00 02 99 02
			39 01 00 00 00 00 02 9A EA
			39 01 00 00 00 00 02 9B 03
			39 01 00 00 00 00 02 9C 1B
			39 01 00 00 00 00 02 9D 03
			39 01 00 00 00 00 02 9E 3A
			39 01 00 00 00 00 02 9F 03
			39 01 00 00 00 00 02 A0 60
			39 01 00 00 00 00 02 A2 03
			39 01 00 00 00 00 02 A3 6C
			39 01 00 00 00 00 02 A4 03
			39 01 00 00 00 00 02 A5 78
			39 01 00 00 00 00 02 A6 03
			39 01 00 00 00 00 02 A7 83
			39 01 00 00 00 00 02 A9 03
			39 01 00 00 00 00 02 AA 93
			39 01 00 00 00 00 02 AB 03
			39 01 00 00 00 00 02 AC A3
			39 01 00 00 00 00 02 AD 03
			39 01 00 00 00 00 02 AE B5
			39 01 00 00 00 00 02 AF 03
			39 01 00 00 00 00 02 B0 F8
			39 01 00 00 00 00 02 B1 03
			39 01 00 00 00 00 02 B2 FF
			39 01 00 00 00 00 02 B3 00
			39 01 00 00 00 00 02 B4 17
			39 01 00 00 00 00 02 B5 00
			39 01 00 00 00 00 02 B6 43
			39 01 00 00 00 00 02 B7 00
			39 01 00 00 00 00 02 B8 9E
			39 01 00 00 00 00 02 B9 00
			39 01 00 00 00 00 02 BA BD
			39 01 00 00 00 00 02 BB 00
			39 01 00 00 00 00 02 BC D6
			39 01 00 00 00 00 02 BD 00
			39 01 00 00 00 00 02 BE EB
			39 01 00 00 00 00 02 BF 00
			39 01 00 00 00 00 02 C0 FD
			39 01 00 00 00 00 02 C1 01
			39 01 00 00 00 00 02 C2 0D
			39 01 00 00 00 00 02 C3 01
			39 01 00 00 00 00 02 C4 1C
			39 01 00 00 00 00 02 C5 01
			39 01 00 00 00 00 02 C6 4C
			39 01 00 00 00 00 02 C7 01
			39 01 00 00 00 00 02 C8 71
			39 01 00 00 00 00 02 C9 01
			39 01 00 00 00 00 02 CA AC
			39 01 00 00 00 00 02 CB 01
			39 01 00 00 00 00 02 CC D9
			39 01 00 00 00 00 02 CD 02
			39 01 00 00 00 00 02 CE 1E
			39 01 00 00 00 00 02 CF 02
			39 01 00 00 00 00 02 D0 56
			39 01 00 00 00 00 02 D1 02
			39 01 00 00 00 00 02 D2 57
			39 01 00 00 00 00 02 D3 02
			39 01 00 00 00 00 02 D4 8B
			39 01 00 00 00 00 02 D5 02
			39 01 00 00 00 00 02 D6 C5
			39 01 00 00 00 00 02 D7 02
			39 01 00 00 00 00 02 D8 EA
			39 01 00 00 00 00 02 D9 03
			39 01 00 00 00 00 02 DA 1B
			39 01 00 00 00 00 02 DB 03
			39 01 00 00 00 00 02 DC 3A
			39 01 00 00 00 00 02 DD 03
			39 01 00 00 00 00 02 DE 60
			39 01 00 00 00 00 02 DF 03
			39 01 00 00 00 00 02 E0 6C
			39 01 00 00 00 00 02 E1 03
			39 01 00 00 00 00 02 E2 78
			39 01 00 00 00 00 02 E3 03
			39 01 00 00 00 00 02 E4 83
			39 01 00 00 00 00 02 E5 03
			39 01 00 00 00 00 02 E6 93
			39 01 00 00 00 00 02 E7 03
			39 01 00 00 00 00 02 E8 A3
			39 01 00 00 00 00 02 E9 03
			39 01 00 00 00 00 02 EA B5
			39 01 00 00 00 00 02 EB 03
			39 01 00 00 00 00 02 EC F8
			39 01 00 00 00 00 02 ED 03
			39 01 00 00 00 00 02 EE FF
			39 01 00 00 00 00 02 EF 00
			39 01 00 00 00 00 02 F0 77
			39 01 00 00 00 00 02 F1 00
			39 01 00 00 00 00 02 F2 9C
			39 01 00 00 00 00 02 F3 00
			39 01 00 00 00 00 02 F4 9E
			39 01 00 00 00 00 02 F5 00
			39 01 00 00 00 00 02 F6 BD
			39 01 00 00 00 00 02 F7 00
			39 01 00 00 00 00 02 F8 D6
			39 01 00 00 00 00 02 F9 00
			39 01 00 00 00 00 02 FA EB
			39 01 00 00 00 00 02 FF 02
			39 01 00 00 00 00 02 FB 01
			39 01 00 00 00 00 02 00 00
			39 01 00 00 00 00 02 01 FD
			39 01 00 00 00 00 02 02 01
			39 01 00 00 00 00 02 03 0D
			39 01 00 00 00 00 02 04 01
			39 01 00 00 00 00 02 05 1C
			39 01 00 00 00 00 02 06 01
			39 01 00 00 00 00 02 07 4C
			39 01 00 00 00 00 02 08 01
			39 01 00 00 00 00 02 09 71
			39 01 00 00 00 00 02 0A 01
			39 01 00 00 00 00 02 0B AC
			39 01 00 00 00 00 02 0C 01
			39 01 00 00 00 00 02 0D D9
			39 01 00 00 00 00 02 0E 02
			39 01 00 00 00 00 02 0F 1E
			39 01 00 00 00 00 02 10 02
			39 01 00 00 00 00 02 11 56
			39 01 00 00 00 00 02 12 02
			39 01 00 00 00 00 02 13 57
			39 01 00 00 00 00 02 14 02
			39 01 00 00 00 00 02 15 8B
			39 01 00 00 00 00 02 16 02
			39 01 00 00 00 00 02 17 C5
			39 01 00 00 00 00 02 18 02
			39 01 00 00 00 00 02 19 EA
			39 01 00 00 00 00 02 1A 03
			39 01 00 00 00 00 02 1B 1B
			39 01 00 00 00 00 02 1C 03
			39 01 00 00 00 00 02 1D 3A
			39 01 00 00 00 00 02 1E 03
			39 01 00 00 00 00 02 1F 60
			39 01 00 00 00 00 02 20 03
			39 01 00 00 00 00 02 21 6C
			39 01 00 00 00 00 02 22 03
			39 01 00 00 00 00 02 23 78
			39 01 00 00 00 00 02 24 03
			39 01 00 00 00 00 02 25 83
			39 01 00 00 00 00 02 26 03
			39 01 00 00 00 00 02 27 93
			39 01 00 00 00 00 02 28 03
			39 01 00 00 00 00 02 29 A3
			39 01 00 00 00 00 02 2A 03
			39 01 00 00 00 00 02 2B B5
			39 01 00 00 00 00 02 2D 03
			39 01 00 00 00 00 02 2F F8
			39 01 00 00 00 00 02 30 03
			39 01 00 00 00 00 02 31 FF
			39 01 00 00 00 00 02 32 00
			39 01 00 00 00 00 02 33 17
			39 01 00 00 00 00 02 34 00
			39 01 00 00 00 00 02 35 43
			39 01 00 00 00 00 02 36 00
			39 01 00 00 00 00 02 37 9E
			39 01 00 00 00 00 02 38 00
			39 01 00 00 00 00 02 39 BD
			39 01 00 00 00 00 02 3A 00
			39 01 00 00 00 00 02 3B D6
			39 01 00 00 00 00 02 3D 00
			39 01 00 00 00 00 02 3F EB
			39 01 00 00 00 00 02 40 00
			39 01 00 00 00 00 02 41 FD
			39 01 00 00 00 00 02 42 01
			39 01 00 00 00 00 02 43 0D
			39 01 00 00 00 00 02 44 01
			39 01 00 00 00 00 02 45 1C
			39 01 00 00 00 00 02 46 01
			39 01 00 00 00 00 02 47 4C
			39 01 00 00 00 00 02 48 01
			39 01 00 00 00 00 02 49 71
			39 01 00 00 00 00 02 4A 01
			39 01 00 00 00 00 02 4B AC
			39 01 00 00 00 00 02 4C 01
			39 01 00 00 00 00 02 4D D9
			39 01 00 00 00 00 02 4E 02
			39 01 00 00 00 00 02 4F 1E
			39 01 00 00 00 00 02 50 02
			39 01 00 00 00 00 02 51 56
			39 01 00 00 00 00 02 52 02
			39 01 00 00 00 00 02 53 57
			39 01 00 00 00 00 02 54 02
			39 01 00 00 00 00 02 55 8B
			39 01 00 00 00 00 02 56 02
			39 01 00 00 00 00 02 58 C5
			39 01 00 00 00 00 02 59 02
			39 01 00 00 00 00 02 5A EA
			39 01 00 00 00 00 02 5B 03
			39 01 00 00 00 00 02 5C 1B
			39 01 00 00 00 00 02 5D 03
			39 01 00 00 00 00 02 5E 3A
			39 01 00 00 00 00 02 5F 03
			39 01 00 00 00 00 02 60 60
			39 01 00 00 00 00 02 61 03
			39 01 00 00 00 00 02 62 6C
			39 01 00 00 00 00 02 63 03
			39 01 00 00 00 00 02 64 78
			39 01 00 00 00 00 02 65 03
			39 01 00 00 00 00 02 66 83
			39 01 00 00 00 00 02 67 03
			39 01 00 00 00 00 02 68 93
			39 01 00 00 00 00 02 69 03
			39 01 00 00 00 00 02 6A A3
			39 01 00 00 00 00 02 6B 03
			39 01 00 00 00 00 02 6C B5
			39 01 00 00 00 00 02 6D 03
			39 01 00 00 00 00 02 6E F8
			39 01 00 00 00 00 02 6F 03
			39 01 00 00 00 00 02 70 FF
			39 01 00 00 00 00 02 71 00
			39 01 00 00 00 00 02 72 77
			39 01 00 00 00 00 02 73 00
			39 01 00 00 00 00 02 74 9C
			39 01 00 00 00 00 02 75 00
			39 01 00 00 00 00 02 76 9E
			39 01 00 00 00 00 02 77 00
			39 01 00 00 00 00 02 78 BD
			39 01 00 00 00 00 02 79 00
			39 01 00 00 00 00 02 7A D6
			39 01 00 00 00 00 02 7B 00
			39 01 00 00 00 00 02 7C EB
			39 01 00 00 00 00 02 7D 00
			39 01 00 00 00 00 02 7E FD
			39 01 00 00 00 00 02 7F 01
			39 01 00 00 00 00 02 80 0D
			39 01 00 00 00 00 02 81 01
			39 01 00 00 00 00 02 82 1C
			39 01 00 00 00 00 02 83 01
			39 01 00 00 00 00 02 84 4C
			39 01 00 00 00 00 02 85 01
			39 01 00 00 00 00 02 86 71
			39 01 00 00 00 00 02 87 01
			39 01 00 00 00 00 02 88 AC
			39 01 00 00 00 00 02 89 01
			39 01 00 00 00 00 02 8A D9
			39 01 00 00 00 00 02 8B 02
			39 01 00 00 00 00 02 8C 1E
			39 01 00 00 00 00 02 8D 02
			39 01 00 00 00 00 02 8E 56
			39 01 00 00 00 00 02 8F 02
			39 01 00 00 00 00 02 90 57
			39 01 00 00 00 00 02 91 02
			39 01 00 00 00 00 02 92 8B
			39 01 00 00 00 00 02 93 02
			39 01 00 00 00 00 02 94 C5
			39 01 00 00 00 00 02 95 02
			39 01 00 00 00 00 02 96 EA
			39 01 00 00 00 00 02 97 03
			39 01 00 00 00 00 02 98 1B
			39 01 00 00 00 00 02 99 03
			39 01 00 00 00 00 02 9A 3A
			39 01 00 00 00 00 02 9B 03
			39 01 00 00 00 00 02 9C 60
			39 01 00 00 00 00 02 9D 03
			39 01 00 00 00 00 02 9E 6C
			39 01 00 00 00 00 02 9F 03
			39 01 00 00 00 00 02 A0 78
			39 01 00 00 00 00 02 A2 03
			39 01 00 00 00 00 02 A3 83
			39 01 00 00 00 00 02 A4 03
			39 01 00 00 00 00 02 A5 93
			39 01 00 00 00 00 02 A6 03
			39 01 00 00 00 00 02 A7 A3
			39 01 00 00 00 00 02 A9 03
			39 01 00 00 00 00 02 AA B5
			39 01 00 00 00 00 02 AB 03
			39 01 00 00 00 00 02 AC F8
			39 01 00 00 00 00 02 AD 03
			39 01 00 00 00 00 02 AE FF
			39 01 00 00 00 00 02 AF 00
			39 01 00 00 00 00 02 B0 17
			39 01 00 00 00 00 02 B1 00
			39 01 00 00 00 00 02 B2 43
			39 01 00 00 00 00 02 B3 00
			39 01 00 00 00 00 02 B4 9E
			39 01 00 00 00 00 02 B5 00
			39 01 00 00 00 00 02 B6 BD
			39 01 00 00 00 00 02 B7 00
			39 01 00 00 00 00 02 B8 D6
			39 01 00 00 00 00 02 B9 00
			39 01 00 00 00 00 02 BA EB
			39 01 00 00 00 00 02 BB 00
			39 01 00 00 00 00 02 BC FD
			39 01 00 00 00 00 02 BD 01
			39 01 00 00 00 00 02 BE 0D
			39 01 00 00 00 00 02 BF 01
			39 01 00 00 00 00 02 C0 1C
			39 01 00 00 00 00 02 C1 01
			39 01 00 00 00 00 02 C2 4C
			39 01 00 00 00 00 02 C3 01
			39 01 00 00 00 00 02 C4 71
			39 01 00 00 00 00 02 C5 01
			39 01 00 00 00 00 02 C6 AC
			39 01 00 00 00 00 02 C7 01
			39 01 00 00 00 00 02 C8 D9
			39 01 00 00 00 00 02 C9 02
			39 01 00 00 00 00 02 CA 1E
			39 01 00 00 00 00 02 CB 02
			39 01 00 00 00 00 02 CC 56
			39 01 00 00 00 00 02 CD 02
			39 01 00 00 00 00 02 CE 57
			39 01 00 00 00 00 02 CF 02
			39 01 00 00 00 00 02 D0 8B
			39 01 00 00 00 00 02 D1 02
			39 01 00 00 00 00 02 D2 C5
			39 01 00 00 00 00 02 D3 02
			39 01 00 00 00 00 02 D4 EA
			39 01 00 00 00 00 02 D5 03
			39 01 00 00 00 00 02 D6 1B
			39 01 00 00 00 00 02 D7 03
			39 01 00 00 00 00 02 D8 3A
			39 01 00 00 00 00 02 D9 03
			39 01 00 00 00 00 02 DA 60
			39 01 00 00 00 00 02 DB 03
			39 01 00 00 00 00 02 DC 6C
			39 01 00 00 00 00 02 DD 03
			39 01 00 00 00 00 02 DE 78
			39 01 00 00 00 00 02 DF 03
			39 01 00 00 00 00 02 E0 83
			39 01 00 00 00 00 02 E1 03
			39 01 00 00 00 00 02 E2 93
			39 01 00 00 00 00 02 E3 03
			39 01 00 00 00 00 02 E4 A3
			39 01 00 00 00 00 02 E5 03
			39 01 00 00 00 00 02 E6 B5
			39 01 00 00 00 00 02 E7 03
			39 01 00 00 00 00 02 E8 F8
			39 01 00 00 00 00 02 E9 03
			39 01 00 00 00 00 02 EA FF
			39 01 00 00 00 00 02 FF 05
			39 01 00 00 00 00 02 FB 01
			39 01 00 00 00 00 02 00 38
			39 01 00 00 00 00 02 01 38
			39 01 00 00 00 00 02 02 07
			39 01 00 00 00 00 02 03 40
			39 01 00 00 00 00 02 04 40
			39 01 00 00 00 00 02 05 25
			39 01 00 00 00 00 02 06 1D
			39 01 00 00 00 00 02 07 23
			39 01 00 00 00 00 02 08 1B
			39 01 00 00 00 00 02 09 21
			39 01 00 00 00 00 02 0A 19
			39 01 00 00 00 00 02 0B 1F
			39 01 00 00 00 00 02 0C 17
			39 01 00 00 00 00 02 0D 05
			39 01 00 00 00 00 02 0E 04
			39 01 00 00 00 00 02 0F 0F
			39 01 00 00 00 00 02 10 38
			39 01 00 00 00 00 02 11 38
			39 01 00 00 00 00 02 12 38
			39 01 00 00 00 00 02 13 38
			39 01 00 00 00 00 02 14 38
			39 01 00 00 00 00 02 15 38
			39 01 00 00 00 00 02 16 06
			39 01 00 00 00 00 02 17 40
			39 01 00 00 00 00 02 18 40
			39 01 00 00 00 00 02 19 24
			39 01 00 00 00 00 02 1A 1C
			39 01 00 00 00 00 02 1B 22
			39 01 00 00 00 00 02 1C 1A
			39 01 00 00 00 00 02 1D 20
			39 01 00 00 00 00 02 1E 18
			39 01 00 00 00 00 02 1F 1E
			39 01 00 00 00 00 02 20 16
			39 01 00 00 00 00 02 21 05
			39 01 00 00 00 00 02 22 04
			39 01 00 00 00 00 02 23 0E
			39 01 00 00 00 00 02 24 38
			39 01 00 00 00 00 02 25 38
			39 01 00 00 00 00 02 26 38
			39 01 00 00 00 00 02 27 38
			39 01 00 00 00 00 02 28 38
			39 01 00 00 00 00 02 29 38
			39 01 00 00 00 00 02 2A 0E
			39 01 00 00 00 00 02 2B 40
			39 01 00 00 00 00 02 2D 40
			39 01 00 00 00 00 02 2F 16
			39 01 00 00 00 00 02 30 1E
			39 01 00 00 00 00 02 31 18
			39 01 00 00 00 00 02 32 20
			39 01 00 00 00 00 02 33 1A
			39 01 00 00 00 00 02 34 22
			39 01 00 00 00 00 02 35 1C
			39 01 00 00 00 00 02 36 24
			39 01 00 00 00 00 02 37 05
			39 01 00 00 00 00 02 38 04
			39 01 00 00 00 00 02 39 06
			39 01 00 00 00 00 02 3A 38
			39 01 00 00 00 00 02 3B 38
			39 01 00 00 00 00 02 3D 38
			39 01 00 00 00 00 02 3F 38
			39 01 00 00 00 00 02 40 38
			39 01 00 00 00 00 02 41 38
			39 01 00 00 00 00 02 42 0F
			39 01 00 00 00 00 02 43 40
			39 01 00 00 00 00 02 44 40
			39 01 00 00 00 00 02 45 17
			39 01 00 00 00 00 02 46 1F
			39 01 00 00 00 00 02 47 19
			39 01 00 00 00 00 02 48 21
			39 01 00 00 00 00 02 49 1B
			39 01 00 00 00 00 02 4A 23
			39 01 00 00 00 00 02 4B 1D
			39 01 00 00 00 00 02 4C 25
			39 01 00 00 00 00 02 4D 05
			39 01 00 00 00 00 02 4E 04
			39 01 00 00 00 00 02 4F 07
			39 01 00 00 00 00 02 50 38
			39 01 00 00 00 00 02 51 38
			39 01 00 00 00 00 02 52 38
			39 01 00 00 00 00 02 53 38
			39 01 00 00 00 00 02 5B 0A
			39 01 00 00 00 00 02 5C 0A
			39 01 00 00 00 00 02 63 0A
			39 01 00 00 00 00 02 64 15
			39 01 00 00 00 00 02 68 24
			39 01 00 00 00 00 02 69 24
			39 01 00 00 00 00 02 90 7B
			39 01 00 00 00 00 02 91 11
			39 01 00 00 00 00 02 92 14
			39 01 00 00 00 00 02 7E 10
			39 01 00 00 00 00 02 7F 10
			39 01 00 00 00 00 02 80 00
			39 01 00 00 00 00 02 98 00
			39 01 00 00 00 00 02 99 00
			39 01 00 00 00 00 02 54 2E
			39 01 00 00 00 00 02 59 38
			39 01 00 00 00 00 02 5D 01
			39 01 00 00 00 00 02 5E 27
			39 01 00 00 00 00 02 62 39
			39 01 00 00 00 00 02 66 88
			39 01 00 00 00 00 02 67 11
			39 01 00 00 00 00 02 6A 0E
			39 01 00 00 00 00 02 6B 20
			39 01 00 00 00 00 02 6C 08
			39 01 00 00 00 00 02 6D 00
			39 01 00 00 00 00 02 7D 01
			39 01 00 00 00 00 02 B7 01
			39 01 00 00 00 00 02 B8 0A
			39 01 00 00 00 00 02 BA 13
			39 01 00 00 00 00 02 BC 01
			39 01 00 00 00 00 02 BD 55
			39 01 00 00 00 00 02 BE 38
			39 01 00 00 00 00 02 BF 44
			39 01 00 00 00 00 02 CF 88
			39 01 00 00 00 00 02 C8 00
			39 01 00 00 00 00 02 C9 55
			39 01 00 00 00 00 02 CA 00
			39 01 00 00 00 00 02 CB 55
			39 01 00 00 00 00 02 CC A2
			39 01 00 00 00 00 02 CE 88
			39 01 00 00 00 00 02 CF 88
			39 01 00 00 00 00 02 D0 00
			39 01 00 00 00 00 02 D1 00
			39 01 00 00 00 00 02 D3 00
			39 01 00 00 00 00 02 D5 00
			39 01 00 00 00 00 02 D6 22
			39 01 00 00 00 00 02 D7 31
			39 01 00 00 00 00 02 D8 7E
			39 01 00 00 00 00 02 FF 01
			39 01 00 00 00 00 02 FB 01
			39 01 00 00 00 00 02 6E 80
			39 01 00 00 00 00 02 FF 00
			39 01 00 00 00 00 02 FB 01
			39 01 00 00 00 00 02 D3 15
			39 01 00 00 00 00 02 D4 10
			39 01 00 00 00 00 02 D5 18
			39 01 00 00 00 00 02 D6 B8
			39 01 00 00 00 00 02 D7 00
			39 01 00 00 00 00 02 55 80
			05 01 00 00 78 00 02 11 00
			05 01 00 00 32 00 02 29 00
			];
		qcom,mdss-dsi-off-command = [
			05 01 00 00 32 00 02 28 00
			05 01 00 00 78 00 02 10 00
			];
		qcom,panel-ce-cmds = [
			29 01 00 00 00 00 02 55 93
			];
		qcom,panel-ce-off-cmds = [
			29 01 00 00 00 00 02 55 03
			];
		qcom,panel-ce-level1-cmds = [
			29 01 00 00 00 00 02 55 83
			];
		qcom,panel-ce-level2-cmds = [
			29 01 00 00 00 00 02 55 93
			];
		qcom,panel-ce-level3-cmds = [
			29 01 00 00 00 00 02 55 B3
			];
		qcom,panel-cabc-ui-cmds = [
			29 01 00 00 00 00 02 55 91
			];
		qcom,panel-cabc-still-cmds = [
			29 01 00 00 00 00 02 55 92
			];
		qcom,panel-cabc-moving-cmds = [
			29 01 00 00 00 00 02 55 93
			];
		qcom,panel-cabc-off-cmds = [
			29 01 00 00 00 00 02 55 00
			];
		qcom,panel-backlight-response-curve = [
			00 01 01 01 01 01 01 02
			02 02 03 03 03 04 04 04
			05 05 06 06 06 07 07 07
			08 08 09 09 09 0A 0A 0A
			0B 0B 0C 0C 0C 0D 0D 0E
			0E 0E 0F 0F 0F 10 10 11
			11 11 12 12 12 13 13 14
			14 14 15 15 16 16 16 17
			17 17 18 18 19 19 19 1A
			1A 1A 1B 1B 1C 1C 1C 1D
			1D 1E 1E 1E 1F 1F 1F 20
			20 21 21 21 22 22 22 23
			23 24 24 24 25 25 26 26
			27 28 29 2A 2B 2C 2D 2E
			2F 30 31 32 33 34 35 36
			37 38 38 39 3A 3B 3C 3D
			3E 3F 40 41 42 43 44 45
			46 47 48 49 4A 4A 4B 4C
			4D 4E 4F 50 51 52 53 54
			55 56 57 58 59 5A 5B 5C
			5D 5D 5E 5F 60 61 62 63
			64 65 66 67 68 69 6A 6B
			6C 6D 6E 6F 70 71 72 74
			75 76 78 79 7B 7C 7D 7F
			80 82 83 84 86 87 88 8A
			8B 8D 8E 8F 91 92 94 95
			96 98 99 9A 9C 9D 9F A0
			A1 A3 A4 A6 A7 A8 AA AB
			AD AE AF B1 B2 B3 B5 B6
			B8 B9 BA BC BD BF C0 C1
			C3 C4 C5 C7 C8 CA CB CC
			CE CF D1 D2 D3 D5 D6 D8
		];
		qcom,mdss-dsi-on-command-state = "dsi_lp_mode";
		qcom,mdss-dsi-off-command-state = "dsi_lp_mode";
    /**************************************************
		qcom,esd-check-enabled;							//esd
		qcom,panel-alive-reg-content = [
				0A 01 9C
				];
		qcom,mdss-dsi-panel-status-command = [06 01 00 01 05 00 02 0A 08];
		qcom,mdss-dsi-panel-status-command-state = "dsi_lp_mode";
		qcom,mdss-dsi-panel-status-check-mode = "reg_read";		//esd
    ***************************************************/
		qcom,mdss-dsi-h-sync-pulse = <1>;
		qcom,mdss-dsi-traffic-mode = "burst_mode";
		qcom,mdss-dsi-bllp-eof-power-mode;
		qcom,mdss-dsi-bllp-power-mode;
		qcom,mdss-dsi-lane-0-state;
		qcom,mdss-dsi-lane-1-state;
		qcom,mdss-dsi-lane-2-state;
		qcom,mdss-dsi-lane-3-state;
		qcom,mdss-dsi-panel-timings = [EE 38 26 00 6A 6C 2C 3C 2C 03 04 00];
		qcom,mdss-dsi-t-clk-post = <0x02>;
		qcom,mdss-dsi-t-clk-pre = <0x2C>;
		qcom,mdss-dsi-bl-min-level = <1>;
		qcom,mdss-dsi-bl-max-level = <4095>;
		qcom,mdss-dsi-dma-trigger = "trigger_sw";
		qcom,mdss-dsi-mdp-trigger = "none";
		qcom,mdss-dsi-bl-pmic-control-type = "bl_ctrl_wled";
		qcom,mdss-dsi-reset-sequence = <1 20>, <0 10>, <1 20>;
		qcom,mdss-pan-physical-width-dimension = <68>;
		qcom,mdss-pan-physical-height-dimension = <121>;
		qcom,mdss-dsi-lp11-init;
		qcom,mdss-dsi-init-delay-us = <200>;
		qcom,suspend-ulps-enabled;
		qcom,mdss-dsi-avdd-avee-enabled;
		qcom,mdss-dsi-avdd-init-lcd-voltage = <5500000>;
		qcom,mdss-dsi-avee-init-lcd-voltage = <5500000>;
		qcom,mdss-dsi-resetdown-after-avdd-avee-enabled;
	};
};
