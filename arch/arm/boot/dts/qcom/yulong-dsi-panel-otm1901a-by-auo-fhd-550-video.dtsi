/* Copyright (c) 2014, The Linux Foundation. All rights reserved.
 *
 * This program is free software; you can redistribute it and/or modify
 * it under the terms of the GNU General Public License version 2 and
 * only version 2 as published by the Free Software Foundation.
 *
 * This program is distributed in the hope that it will be useful,
 * but WITHOUT ANY WARRANTY; without even the implied warranty of
 * MERCHANTABILITY or FITNESS FOR A PARTICULAR PURPOSE.  See the
 * GNU General Public License for more details.
 */

/*---------------------------------------------------------------------------
 * This file is autogenerated file using gcdb parser. Please do not edit it.
 * Update input XML file to add a new entry or update variable in this file
 * VERSION = "1.0"
 *---------------------------------------------------------------------------*/

&mdss_mdp {
	dsi_otm1901a_by_auo_fhd_vid: qcom,mdss_dsi_otm1901a_by_auo_fhd_video {
		qcom,cont-splash-enabled;
		qcom,mdss-dsi-panel-name = "LCD_TYPE_OTM1901A_BY_AUO_FHD_550";
		qcom,mdss-dsi-panel-type = "dsi_video_mode";
		qcom,mdss-dsi-panel-framerate = <60>;
		qcom,mdss-dsi-virtual-channel-id = <0>;
		qcom,mdss-dsi-stream = <0>;
		qcom,mdss-dsi-panel-width = <1080>;
		qcom,mdss-dsi-panel-height = <1920>;
		qcom,mdss-dsi-h-front-porch = <140>;
		qcom,mdss-dsi-h-back-porch = <138>;
		qcom,mdss-dsi-h-pulse-width = <20>;
		qcom,mdss-dsi-h-sync-skew = <0>;
		qcom,mdss-dsi-v-back-porch = <9>;
		qcom,mdss-dsi-v-front-porch = <14>;
		qcom,mdss-dsi-v-pulse-width = <2>;
		qcom,mdss-dsi-h-left-border = <0>;
		qcom,mdss-dsi-h-right-border = <0>;
		qcom,mdss-dsi-v-top-border = <0>;
		qcom,mdss-dsi-v-bottom-border = <0>;
		qcom,mdss-dsi-bpp = <24>;
		qcom,mdss-dsi-underflow-color = <0xff>;
		qcom,mdss-dsi-border-color = <0>;
		qcom,mdss-dsi-pixel-packing = <0>;
		qcom,mdss-dsi-on-command = [
			39 01 00 00 00 00 02 00 00
			39 01 00 00 00 00 05 FF 19 01 01 00
			39 01 00 00 00 00 02 00 80
			39 01 00 00 00 00 03 FF 19 01
			39 01 00 00 00 00 02 00 00
			39 01 00 00 00 00 02 1C 33
			39 01 00 00 00 00 02 00 A0
			39 01 00 00 00 00 02 C1 E8
			39 01 00 00 00 00 02 00 A7
			39 01 00 00 00 00 02 C1 00
			39 01 00 00 00 00 02 00 90
			39 01 00 00 00 00 07 C0 00 2F 00 00 00 01
			39 01 00 00 00 00 02 00 C0
			39 01 00 00 00 00 07 C0 00 2F 00 00 00 01
			39 01 00 00 00 00 02 00 9A
			39 01 00 00 00 00 02 C0 1E
			39 01 00 00 00 00 02 00 AC
			39 01 00 00 00 00 02 C0 06
			39 01 00 00 00 00 02 00 DC
			39 01 00 00 00 00 02 C0 06
			39 01 00 00 00 00 02 00 81
			39 01 00 00 00 00 02 A5 06
			39 01 00 00 00 00 02 00 82
			39 01 00 00 00 00 02 C4 F0
			39 01 00 00 00 00 02 00 92
			39 01 00 00 00 00 02 E9 00
			39 01 00 00 00 00 02 00 90
			39 01 00 00 00 00 02 F3 01
			39 01 00 00 00 00 02 00 93
			39 01 00 00 00 00 02 C5 1E
			39 01 00 00 00 00 02 00 95
			39 01 00 00 00 00 02 C5 32
			39 01 00 00 00 00 02 00 97
			39 01 00 00 00 00 02 C5 19
			39 01 00 00 00 00 02 00 99
			39 01 00 00 00 00 02 C5 2D
			39 01 00 00 00 00 02 00 9B
			39 01 00 00 00 00 03 C5 33 30
			39 01 00 00 00 00 02 00 00
			39 01 00 00 00 00 03 D9 00 AB
			39 01 00 00 00 00 02 00 00
			39 01 00 00 00 00 03 D8 1F 1F
			39 01 00 00 00 00 02 00 B3
			39 01 00 00 00 00 02 C0 CC
			39 01 00 00 00 00 02 00 BC
			39 01 00 00 00 00 02 C0 00
			39 01 00 00 00 00 02 00 84
			39 01 00 00 00 00 02 C4 22
			39 01 00 00 00 00 02 00 94
			39 01 00 00 00 00 02 C1 84
			39 01 00 00 00 00 02 00 98
			39 01 00 00 00 00 02 C1 74
			39 01 00 00 00 00 02 00 80
			39 01 00 00 00 00 02 C4 38
			39 01 00 00 00 00 02 00 CD
			39 01 00 00 00 00 02 F5 19
			39 01 00 00 00 00 02 00 DB
			39 01 00 00 00 00 02 F5 19
			39 01 00 00 00 00 02 00 F5
			39 01 00 00 00 00 02 C1 40
			39 01 00 00 00 00 02 00 B9
			39 01 00 00 00 00 02 C0 11
			39 01 00 00 00 00 02 00 8D
			39 01 00 00 00 00 02 F5 20
			39 01 00 00 00 00 02 00 80
			39 01 00 00 00 00 0F C0 00 7F 00 0A 0A 00 7F 0A 0A 00 7F 00 0A 0A
			39 01 00 00 00 00 02 00 F0
			39 01 00 00 00 00 07 C3 00 00 00 00 00 80
			39 01 00 00 00 00 02 00 A0
			39 01 00 00 00 00 08 C0 00 00 0A 00 00 1E 06
			39 01 00 00 00 00 02 00 D0
			39 01 00 00 00 00 08 C0 00 00 0A 00 00 1E 06
			39 01 00 00 00 00 02 00 90
			39 01 00 00 00 00 05 C2 82 00 36 47
			39 01 00 00 00 00 02 00 B0
			39 01 00 00 00 00 09 C2 01 00 3E 4A 01 01 3E 4A
			39 01 00 00 00 00 02 00 80
			39 01 00 00 00 00 0D C3 84 04 01 00 09 01 83 04 01 00 09 01
			39 01 00 00 00 00 02 00 80
			39 01 00 00 00 00 10 CC 09 0D 11 12 13 14 15 16 17 18 0E 28 28 28 28
			39 01 00 00 00 00 02 00 90
			39 01 00 00 00 00 10 CC 0D 09 12 11 13 14 15 16 17 18 0E 28 28 28 28
			39 01 00 00 00 00 02 00 A0
			39 01 00 00 00 00 10 CC 1D 1E 1F 19 1A 1B 1C 20 21 22 23 24 25 26 27
			39 01 00 00 00 00 02 00 B0
			39 01 00 00 00 00 09 CC 01 02 03 05 06 07 04 08
			39 01 00 00 00 00 02 00 C0
			39 01 00 00 00 00 0D CC 00 00 00 00 00 00 00 00 00 00 00 77
			39 01 00 00 00 00 02 00 D0
			39 01 00 00 00 00 0D CC FF 00 30 C0 0F 30 00 00 33 03 00 77
			39 01 00 00 00 00 02 00 DE
			39 01 00 00 00 00 02 CC 00
			39 01 00 00 00 00 02 00 80
			39 01 00 00 00 00 10 CB 00 00 00 00 00 00 00 00 00 00 30 00 00 00 00
			39 01 00 00 00 00 02 00 90
			39 01 00 00 00 00 10 CB 30 00 FF 00 00 00 00 00 00 00 00 00 00 00 00
			39 01 00 00 00 00 02 00 A0
			39 01 00 00 00 00 10 CB 15 15 05 F5 01 01 00 00 00 00 01 00 00 00 00
			39 01 00 00 00 00 02 00 B0
			39 01 00 00 00 00 10 CB 00 01 FD 00 00 00 00 00 00 00 00 00 00 00 00
			39 01 00 00 00 00 02 00 C0
			39 01 00 00 00 00 09 CB 00 00 00 00 00 00 77 77
			39 01 00 00 00 00 02 00 D0
			39 01 00 00 00 00 09 CB 00 00 00 00 00 00 77 77
			39 01 00 00 00 00 02 00 E0
			39 01 00 00 00 00 09 CB 00 00 00 01 01 01 77 77
			39 01 00 00 00 00 02 00 F0
			39 01 00 00 00 00 09 CB 11 11 11 11 11 11 77 77
			39 01 00 00 00 00 02 00 80
			39 01 00 00 00 00 10 CD 3F 3F 3F 3F 3F 3F 3F 3F 01 12 11 03 04 0B 17
			39 01 00 00 00 00 02 00 90
			39 01 00 00 00 00 0C CD 3D 02 3D 25 25 25 1F 20 21 25 25
			39 01 00 00 00 00 02 00 A0
			39 01 00 00 00 00 10 CD 3F 3F 3F 3F 3F 3F 3F 3F 01 12 11 03 04 0B 17
			39 01 00 00 00 00 02 00 B0
			39 01 00 00 00 00 0C CD 17 02 3D 25 25 25 1F 20 21 25 25
			39 01 00 00 00 00 02 00 00
			39 01 00 00 00 00 19 E1 00 23 2c 37 40 47 53 64 6c 7e 88 90 6b 67 63 54 45 34 2a 23 1c 15 11 00
			39 01 00 00 00 00 02 00 00
			39 01 00 00 00 00 19 E2 00 23 2c 37 40 47 53 64 6c 7e 88 90 6b 67 63 54 45 34 2a 23 1c 15 11 00
			39 01 00 00 00 00 02 00 00
			39 01 00 00 00 00 19 E3 00 23 2c 37 40 47 53 64 6c 7e 88 90 6b 67 63 54 45 34 2a 23 1c 15 11 00
			39 01 00 00 00 00 02 00 00
			39 01 00 00 00 00 19 E4 00 23 2c 37 40 47 53 64 6c 7e 88 90 6b 67 63 54 45 34 2a 23 1c 15 11 00
			39 01 00 00 00 00 02 00 00
			39 01 00 00 00 00 19 E5 00 23 2c 37 40 47 53 64 6c 7e 88 90 6b 67 63 54 45 34 2a 23 1c 15 11 00
			39 01 00 00 00 00 02 00 00
			39 01 00 00 00 00 19 E6 00 23 2c 37 40 47 53 64 6c 7e 88 90 6b 67 63 54 45 34 2a 23 1c 15 11 00
			39 01 00 00 00 00 02 00 D4
			39 01 00 00 00 00 05 C3 01 01 01 01
			39 01 00 00 00 00 02 00 F7
			39 01 00 00 00 00 05 C3 03 1B 00 00
			39 01 00 00 00 00 02 00 F2
			39 01 00 00 00 00 04 C1 80 0F 0F
			39 01 00 00 00 00 02 00 B0
			39 01 00 00 00 00 02 CA 04
			39 01 00 00 00 00 02 00 B1
			39 01 00 00 00 00 02 CA 04
			39 01 00 00 00 00 02 00 B3
			39 01 00 00 00 00 02 CA 48
			39 01 00 00 00 00 02 00 90
			39 01 00 00 00 00 02 B0 00
			39 01 00 00 00 00 02 00 D0
			39 01 00 00 00 00 05 F5 00 00 00 00
			39 01 00 00 00 00 02 00 80
			39 01 00 00 00 00 02 C4 18
			39 01 00 00 00 00 02 00 00
			39 01 00 00 00 00 04 FF FF FF FF
			05 01 00 00 78 00 02 11 00
			05 01 00 00 14 00 02 29 00
			39 01 00 00 00 00 02 00 00
			39 01 00 00 00 00 03 99 00 00
			];
		qcom,mdss-dsi-off-command = [
			05 01 00 00 32 00 02 28 00
			05 01 00 00 78 00 02 10 00
			];
		qcom,panel-ce-cmds = [
			29 01 00 00 00 00 02 55 93
			];
		qcom,panel-ce-off-cmds = [
			29 01 00 00 00 00 02 55 03
			];
		qcom,panel-ce-level1-cmds = [
			29 01 00 00 00 00 02 55 83
			];
		qcom,panel-ce-level2-cmds = [
			29 01 00 00 00 00 02 55 93
			];
		qcom,panel-ce-level3-cmds = [
			29 01 00 00 00 00 02 55 B3
			];
		qcom,panel-cabc-ui-cmds = [
			29 01 00 00 00 00 02 55 91
			];
		qcom,panel-cabc-still-cmds = [
			29 01 00 00 00 00 02 55 92
			];
		qcom,panel-cabc-moving-cmds = [
			29 01 00 00 00 00 02 55 93
			];
		qcom,panel-cabc-off-cmds = [
			29 01 00 00 00 00 02 55 00
			];
		qcom,panel-backlight-response-curve = [
			00 01 01 01 02 02 02 03
			03 03 03 04 04 05 05 06
			06 07 07 08 08 09 09 0A
			0A 0B 0B 0C 0C 0D 0D 0E
			0E 0F 0F 10 10 11 11 12
			12 12 12 13 13 13 13 14
			14 14 14 15 15 15 15 16
			16 16 16 17 17 17 17 18
			18 18 18 19 19 19 19 1A
			1A 1A 1A 1B 1B 1B 1B 1C
			1C 1C 1C 1D 1D 1D 1D 1E
			1E 1E 1E 1F 1F 1F 1F 20
			20 20 20 21 21 21 21 22
			24 26 28 2A 2C 2E 30 32
			34 36 38 3A 3C 3E 40 42
			44 46 48 4A 4B 4C 4D 4E
			4F 50 51 51 52 53 54 54
			55 56 57 57 58 59 5A 5B
			5C 5E 5F 61 62 64 65 67
			68 6A 6B 6C 6E 6F 71 72
			74 75 77 78 7A 7B 7D 7E
			7F 81 82 84 85 87 89 8B
			8C 8D 8E 90 91 92 94 95
			97 98 9A 9B 9D 9E A0 A1
			A3 A4 A5 A7 A8 AA AB AD
			AE AF B1 B3 B4 B5 B7 B8
			BA BB BD BE BF C1 C4 C5
			C7 C8 C9 CA CB CD CE D0
			D1 D3 D4 D6 D7 D9 DA DB
			DD DE E0 E1 E3 E4 E6 E7
			E9 EA EC ED EE F0 F1 F3
			F4 F6 F7 F9 FA FC FD FF
		];
		qcom,mdss-dsi-on-command-state = "dsi_lp_mode";
		qcom,mdss-dsi-off-command-state = "dsi_lp_mode";
    /**************************************************
		qcom,esd-check-enabled;							//esd
		qcom,panel-alive-reg-content = [
				0A 01 9C
				];
		qcom,mdss-dsi-panel-status-command = [06 01 00 01 05 00 02 0A 08];
		qcom,mdss-dsi-panel-status-command-state = "dsi_lp_mode";
		qcom,mdss-dsi-panel-status-check-mode = "reg_read";		//esd
    ***************************************************/
		qcom,mdss-dsi-h-sync-pulse = <1>;
		qcom,mdss-dsi-traffic-mode = "burst_mode";
		qcom,mdss-dsi-bllp-eof-power-mode;
		qcom,mdss-dsi-bllp-power-mode;
		qcom,mdss-dsi-lane-0-state;
		qcom,mdss-dsi-lane-1-state;
		qcom,mdss-dsi-lane-2-state;
		qcom,mdss-dsi-lane-3-state;
		qcom,mdss-dsi-panel-timings = [F8 3C 28 00 6E 72 2E 40 30 03 04 00];
		qcom,mdss-dsi-t-clk-post = <0x02>;
		qcom,mdss-dsi-t-clk-pre = <0x2D>;
		qcom,mdss-dsi-bl-min-level = <1>;
		qcom,mdss-dsi-bl-max-level = <4095>;
		qcom,mdss-dsi-dma-trigger = "trigger_sw";
		qcom,mdss-dsi-mdp-trigger = "none";
		qcom,mdss-dsi-bl-pmic-control-type = "bl_ctrl_wled";
		qcom,mdss-dsi-reset-sequence = <1 20>, <0 10>, <1 20>;
		qcom,mdss-pan-physical-width-dimension = <68>;
		qcom,mdss-pan-physical-height-dimension = <121>;
		qcom,mdss-dsi-lp11-init;
		qcom,mdss-dsi-init-delay-us = <200>;
		qcom,suspend-ulps-enabled;
		qcom,mdss-dsi-avdd-avee-enabled;
		qcom,mdss-dsi-avdd-init-lcd-voltage = <5500000>;
		qcom,mdss-dsi-avee-init-lcd-voltage = <5500000>;
	};
};
