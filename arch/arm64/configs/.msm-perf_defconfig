## arch/arm64/configs/yl_full_defconfig
```kconfig
CONFIG_DEBUG_SPINLOCK_PANIC_ON_BUG=y
# CONFIG_SECURE_TOUCH is not set
# CONFIG_TOUCHSCREEN_SYNAPTICS_DSX_CORE_v21 is not set
# CONFIG_TOUCHSCREEN_SYNAPTICS_DSX_RMI_DEV_v21 is not set
# CONFIG_TOUCHSCREEN_SYNAPTICS_DSX_FW_UPDATE_v21 is not set
# CONFIG_TOUCHSCREEN_ATMEL_MAXTOUCH_TS is not set
# CONFIG_TOUCHSCREEN_GEN_VKEYS is not set
# CONFIG_TOUCHSCREEN_SYNAPTICS_I2C_RMI4 is not set
# CONFIG_TOUCHSCREEN_SYNAPTICS_DSX_RMI4_DEV is not set
# CONFIG_TOUCHSCREEN_SYNAPTICS_DSX_FW_UPDATE is not set
CONFIG_TOUCHSCREEN_SYNAPTICS_TS_V2_2=y
CONFIG_TOUCHSCREEN_GOODIX=y
CONFIG_TOUCHSCREEN_SHTSC=y
# CONFIG_SMB135X_CHARGER is not set
# CONFIG_SMB349_DUAL_CHARGER is not set
CONFIG_OV8865=y
# CONFIG_FB_MSM_MDSS_HDMI_PANEL is not set
# CONFIG_FB_MSM_MDSS_MHL3 is not set
CONFIG_YL_SENSORS_HALL=y
CONFIG_PSTORE=y
CONFIG_PSTORE_CONSOLE=y
CONFIG_PSTORE_RAM=y
CONFIG_PSTORE_FTRACE=y
CONFIG_MMC_YL_PARAMS=y
CONFIG_LPM_MODE=y
CONFIG_SND_SOC_TFA9890_STUB=y
# CONFIG_VAULTIC is not set
# CONFIG_VAULTIC_SPI is not set
CONFIG_PROC_DEVICETREE=y
CONFIG_INPUT_POLLDEV=y
# CONFIG_QCOM_NPA_DUMP is not set
#add yanghao for mi2s
CONFIG_QCOM_OTHER_MI2S=y
CONFIG_SND_SOC_ES9018=y
CONFIG_TPS65132_LDO=y

#YuLong ADD for BootReason
CONFIG_BOOTREASON=y
#add by fangzhengbo for app profile
CONFIG_APP_PROFILE=y

#YuLong ADD for enlarge log buffer(128K->1M)
CONFIG_LOG_BUF_SHIFT=20
CONFIG_SECURITY_SELINUX_BOOTPARAM=y
#YuLong ADD for FPC fingerprint sensor
CONFIG_INPUT_FINGERPRINT=y
CONFIG_FINGERPRINT_FPC_TEE=n
CONFIG_FINGERPRINT_TEE=y

#YuLong ADD for parallel charger
#zhangzhe@20150421
CONFIG_BQ25890_PARALLEL=y
```

## drivers/input/fingerprint/Kconfig
```kconfig
#
# fingerprint driver configuration
#
menuconfig INPUT_FINGERPRINT
	bool "fingerprints"
	help
	  Say Y here, and a list of supported fingerprints will be displayed.
	  This option doesn't affect the kernel.

	  If unsure, say Y.

if INPUT_FINGERPRINT

config FINGERPRINT_FPC_FULL_FUNCTION
       tristate "FPC full function fingerprint driver support"
       depends on SPI_MASTER
       default n
       help
         Say Y here to enable support for charger status check.
         If unsure, say N.

config FINGERPRINT_FPC_TEE
       bool "FPC TEE fingerprint driver support"
       depends on SPI_MASTER
       default n
       help
         Say Y here to enable support for charger status check.
         If unsure, say N.

config FINGERPRINT_TEE
       bool "TEE fingerprint driver support"
       depends on SPI_MASTER
       default n
       help
         Say Y here to enable support for fingerprint tee driver.
         If unsure, say N.
endif
```

## drivers/input/fingerprint/fpc_tee/Kconfig
```kconfig
config FINGERPRINT_FPC_TEE
       default n
       tristate "FPC 1020 family TEE driver support"
       depends on SPI_MASTER
```

## drivers/input/touchscreen/focaltech/Kconfig
```kconfig
config TOUCHSCREEN_FOCALTECH
        tristate "Focaltech touchscreen controllers"
        help
          "Focaltech touchscreen controller driver.
          (now supports FT8716 i2c mode only)
```

## drivers/input/touchscreen/focaltech_v1d3d3/Kconfig
```kconfig
config TOUCHSCREEN_FOCALTECH_V1D3D3
        tristate "Focaltech touchscreen controllers"
        help
          "Focaltech touchscreen controller driver.
          (now supports FT8716 i2c mode only)
```

## drivers/input/touchscreen/shtsc/Kconfig
```kconfig
config TOUCHSCREEN_SHTSC
	tristate "SHARP touchscreen controllers"
	help
	  SHARP touchscreen controller driver.
	  Do not forget to define either TOUCHSCREEN_SHTSC_I2C or TOUCHSCREEN_SHTSC_SPI
	  (now supports LR388K5 i2c mode only)

config TOUCHSCREEN_SHTSC_I2C
	tristate "SHARP touchscreen driver for I2C"
	depends on I2C && TOUCHSCREEN_SHTSC
	help
	  SHARP I2C touchscreen driver

config TOUCHSCREEN_CHARGER_STATUS_CHECK
       bool "touchscreen charger status check support"
       depends on I2C
       default n
       help
         Say Y here to enable support for charger status check.
         If unsure, say N.
```

## drivers/mmc/Kconfig
```kconfig
#
# MMC subsystem configuration
#

menuconfig MMC
	tristate "MMC/SD/SDIO card support"
	depends on HAS_IOMEM
	help
	  This selects MultiMediaCard, Secure Digital and Secure
	  Digital I/O support.

	  If you want MMC/SD/SDIO support, you should say Y here and
	  also to your specific host controller driver.

config MMC_DEBUG
	bool "MMC debugging"
	depends on MMC != n
	help
	  This is an option for use by developers; most people should
	  say N here.  This enables MMC core and driver debugging.

config MMC_PERF_PROFILING
	bool "MMC performance profiling"
	depends on MMC != n
	default n
	help
	  If you say Y here, support will be added for collecting
	  performance numbers at the MMC Queue and Host layers.

config SIM_SD_COMM_SLOT
        bool "SD card and sim card share common slot"
        depends on MMC != n
        default n
        help
        If you say Y here, we will think SD card and sim card share common slot.

config SIM_SD_COMM_SLOT_VERSION2
        bool "SD card and sim card share common slot version2.0"
        depends on MMC != n
        default n
        help
        If you say Y here, we will think SD card and sim card share common slot.


config SIM_SD_COMM_SLOT_VERSION3
        bool "SD card and sim card share common slot version3.0"
        depends on MMC != n
        default n
        help
        If you say Y here, we will think SD card and sim card share common slot.


config SIM_SD_COMM_SLOT_VERSION4
        bool "SD card and sim card share common slot version4.0"
        depends on MMC != n
        default n
        help
        If you say Y here, we will think SD card and sim card share common slot.

if MMC

source "drivers/mmc/core/Kconfig"

source "drivers/mmc/card/Kconfig"

source "drivers/mmc/host/Kconfig"

endif # MMC
```

## drivers/sensors/Kconfig
```kconfig
menu "Sensors Device Driver"

config SENSORS
	bool "Sensors Class Support"
	help
	  This option enables the sensor sysfs class in /sys/class/sensors.
	  You'll need this to do anything useful with sensorss. If unsure, say N.

config SENSORS_SSC
	bool "Enable Sensors Driver Support for SSC"
	help
	  Add support for sensors SSC driver.
	  This driver is used for exercising sensors use case,
	  time syncing with ADSP clock.

config YL_SENSORS_MAG
    tristate "YAS533 or YAS537"
    depends on I2C
    default n
    help
        Say Y here if you have any sensor device (yas537 ...)
        connected to your system and want it to be available to applications.
        Say N here if you have a headless (no yas533...) system.
        If unsure, say Y.
config LPM_MODE
	bool "Sensors LPM mode"
	help
	  This option enables poweroffcharging .
	  You'll need this to do anything useful with sensorss. If unsure, say N.
# Kconfig for YL sensors
if SENSORS
    source "drivers/sensors/sensparams/Kconfig"
    source "drivers/sensors/alsprox/Kconfig"
    source "drivers/sensors/accel/Kconfig"
    source "drivers/sensors/hall/Kconfig"
    source "drivers/sensors/magnetometer/Kconfig"
    source "drivers/sensors/lsm6ds3/Kconfig"
    source "drivers/sensors/remote/Kconfig"
endif
if YL_SENSORS_GSENSOR
source "drivers/sensors/accel/n2dm/Kconfig"
endif
endmenu
```

## drivers/sensors/accel/n2dm/Kconfig
```kconfig
############################################
## 	Kconfig for accel sensors devices
## 	Author:LongJiang
## 	Date:2015-05-14
############################################

config YL_N2DM_GSENSOR
	tristate "N2DM_ACCEL"
	depends on I2C && SYSFS
	default n
	help
		If you say yes here you get support for the N2dm digital
		3-axis accelerometer.

		This driver can also be built as a module.If so, the module
		will be called n2dm.
```

## drivers/sensors/alsprox/Kconfig
```kconfig
menu "alsprox-sensor Device Drivers"

config YL_SENSORS_ALSPROX
	tristate "Generic sensor layer (needed for taos, ltr559, ...)" if EXPERT
	depends on I2C
	default n
	help
	  Say Y here if you have any sensor device (taos, ltr559, ...)
	  connected to your system and want it to be available to applications.
	  Say N here if you have a headless (no taos, no ltr559) system.
	  If unsure, say Y.

if YL_SENSORS_ALSPROX
source "drivers/sensors/alsprox/tmd277x/Kconfig"
source "drivers/sensors/alsprox/ltr559/Kconfig"
source "drivers/sensors/alsprox/pa12200001/Kconfig"
endif

endmenu
```

## drivers/sensors/magnetometer/Kconfig
```kconfig
#
# Magnetometer sensors
#
menu "Magnetometer sensors"

config YL_SENSORS_YAS533
	tristate "Yamaha 3-Axis Magnetometer"
	depends on I2C
	default n
	help
	  Say Y here to add support for the Yamaha 3-Axis Magnetometer.

config YL_SENSORS_YAS537
	tristate "Yamaha 3-Axis Magnetometer"
	depends on I2C
	default n
	help
	   Say Y here to add support for the Yamaha 3-Axis Magnetometer

endmenu
```

## drivers/sensors/remote/Kconfig
```kconfig
menuconfig RAON_REMOTE_CONTROLLER
	bool "Enable Remote IR Controller"
	default y
	---help---
	  Say Y here to get to see options for device drivers for REMOTE IR CONTROLLER.
	  If you say N, all options in this submenu will be skipped and disabled.
if RAON_REMOTE_CONTROLLER

config RAON_REMOTE_CTRL_SOC
	tristate "Remote IR Controller"
	default n
	help
	  This enables support for Remote IR Controller
endif
```

## drivers/usb/typec/Kconfig
```kconfig
config FUSB_30X
    tristate "Fairchild Fusb302 TypeC"
    help
    This driver support the TypeC Fusb302 chip
```

## drivers/yl_debug/Kconfig
```kconfig
#
# mis
#

config ANDROID_DEV_DEBUG 
	bool "android device debug support"
	help
	for debug value & gpio change  

config YULONG_DEBUG 
	bool "debug support"
	help
	for debug value & gpio change  
config YULONG_MODULE_MANAGEMENT 
	bool "yulong module management support"
	help
	  The driver provides an method for on or off device.

config YULONG_USB_UART_SWITCH 
	bool "yulong usb uart switch"
	help
	  The driver provides an method for usb uart switch.	 
config POWER_DEBUG_COOLPAD 
	bool "yulong debug power"
	help
	  for debug power

config APP_PROFILE 
	bool "app profile enable"
	help
	  for app to set cpufreq,gpufreq and cpucore.
```

## fs/exfat/Kconfig
```kconfig
config EXFAT_FS
	bool "The exFAT filesystem"
	default n
	help
	  This is the next generation of the exFAT filesystem.
	  If unsure, say N.
```
